/dts-v1/;

/ {

	__fixups__ {
		accdet = "/fragment@20:target:0";
		audgpio = "/fragment@24:target:0";
		auxadc = "/fragment@31:target:0", "/fragment@32/__overlay__:io-channels:0";
		charger = "/fragment@11:target:0", "/fragment@13:target:0";
		chosen = "/fragment@0:target:0";
		consys = "/fragment@23:target:0";
		dsi_te = "/fragment@50:target:0";
		extcon_usb = "/fragment@26:target:0";
		flashlights_aw36515 = "/fragment@66:target:0";
		flashlights_ocp8132 = "/fragment@28:target:0";
		flashlights_ocp81375 = "/fragment@67:target:0";
		goodix_fp = "/fragment@48:target:0";
		gpio = "/fragment@45:target:0";
		gpio_usage_mapping = "/fragment@44:target:0";
		i2c0 = "/fragment@34:target:0";
		i2c1 = "/fragment@35:target:0";
		i2c2 = "/fragment@2:target:0", "/fragment@3:target:0", "/fragment@36:target:0";
		i2c3 = "/fragment@4:target:0", "/fragment@37:target:0";
		i2c4 = "/fragment@38:target:0";
		i2c5 = "/fragment@5:target:0", "/fragment@39:target:0";
		i2c6 = "/fragment@6:target:0", "/fragment@40:target:0";
		i2c7 = "/fragment@41:target:0";
		i2c8 = "/fragment@42:target:0";
		i2c9 = "/fragment@43:target:0";
		kd_camera_hw1 = "/fragment@7:target:0", "/fragment@60:target:0", "/fragment@64:target:0";
		keypad = "/fragment@18:target:0", "/fragment@62:target:0";
		main_pmic = "/fragment@7/__overlay__:pmic:0", "/fragment@51:target:0";
		md1_sim1_hot_plug_eint = "/fragment@52:target:0";
		md1_sim2_hot_plug_eint = "/fragment@53:target:0";
		md_auxadc = "/fragment@32:target:0";
		mrdump_ext_rst = "/fragment@46:target:0";
		mt_pmic_vcama_ldo_reg = "/fragment@54:target:0", "/fragment@60/__overlay__:vcama-supply:0", "/fragment@60/__overlay__:vcama_sub-supply:0", "/fragment@64/__overlay__:cam0_vcama-supply:0", "/fragment@64/__overlay__:cam1_vcama-supply:0";
		mt_pmic_vcamd_ldo_reg = "/fragment@57:target:0", "/fragment@60/__overlay__:vcamd_main2-supply:0", "/fragment@60/__overlay__:vcamd_sub-supply:0", "/fragment@60/__overlay__:vcamd-supply:0", "/fragment@64/__overlay__:cam0_vcamd-supply:0", "/fragment@64/__overlay__:cam1_vcamd-supply:0", "/fragment@64/__overlay__:cam2_vcamd-supply:0";
		mt_pmic_vcamio_ldo_reg = "/fragment@58:target:0", "/fragment@60/__overlay__:vcamio-supply:0", "/fragment@60/__overlay__:vcamio_sub-supply:0", "/fragment@60/__overlay__:vcamio_main2-supply:0", "/fragment@64/__overlay__:cam0_vcamio-supply:0", "/fragment@64/__overlay__:cam1_vcamio-supply:0", "/fragment@64/__overlay__:cam2_vcamio-supply:0";
		mt_pmic_vibr_ldo_reg = "/fragment@1/__overlay__/regulator_vibrator:vib-supply:0";
		mt_pmic_vldo28_ldo_reg = "/fragment@59:target:0", "/fragment@60/__overlay__:vcamaf-supply:0", "/fragment@60/__overlay__:vcamaf_sub-supply:0", "/fragment@60/__overlay__:vcamaf_main2-supply:0", "/fragment@61/__overlay__:vtouch-supply:0", "/fragment@64/__overlay__:cam0_vcamaf-supply:0";
		mt_pmic_vsim1_ldo_reg = "/fragment@55:target:0";
		mt_pmic_vsim2_ldo_reg = "/fragment@56:target:0";
		mtk_charger_type = "/fragment@12/__overlay__:charger:0", "/fragment@13/__overlay__:charger:0", "/fragment@14:target:0", "/fragment@26/__overlay__:charger:0";
		mtk_gauge = "/fragment@12:target:0";
		mtkfb = "/fragment@9:target:0";
		odm = "/fragment@1:target:0";
		otg_iddig = "/fragment@49:target:0";
		pio = "/fragment@7/__overlay__:camera_input_gpio:0", "/fragment@8:target:0", "/fragment@10:target:0", "/fragment@15/__overlay__/touch@0:novatek,reset-gpio:0", "/fragment@15/__overlay__/touch@0:novatek,irq-gpio:0", "/fragment@17:target:0", "/fragment@19:target:0", "/fragment@21:target:0", "/fragment@22:target:0", "/fragment@25:target:0", "/fragment@27:target:0", "/fragment@29/__overlay__/fingerprint@0:interrupt-parent:0", "/fragment@29/__overlay__/fingerprint@0:irq-gpio-std:0", "/fragment@29/__overlay__/fingerprint@0:reset-gpio-std:0", "/fragment@30:target:0", "/fragment@35/__overlay__/alsps@23:interrupt-parent:0", "/fragment@44/__overlay__:GPIO_SIM2_SIO:0", "/fragment@44/__overlay__:GPIO_SIM2_SRST:0", "/fragment@44/__overlay__:GPIO_SIM2_SCLK:0", "/fragment@44/__overlay__:GPIO_SIM1_SCLK:0", "/fragment@44/__overlay__:GPIO_SIM1_SRST:0", "/fragment@44/__overlay__:GPIO_SIM1_SIO:0", "/fragment@44/__overlay__:GPIO_SIM2_HOT_PLUG:0", "/fragment@44/__overlay__:GPIO_SIM1_HOT_PLUG:0", "/fragment@44/__overlay__:GPIO_FDD_BAND_SUPPORT_DETECT_3RD_PIN:0", "/fragment@44/__overlay__:GPIO_FDD_BAND_SUPPORT_DETECT_2ND_PIN:0", "/fragment@44/__overlay__:GPIO_FDD_BAND_SUPPORT_DETECT_1ST_PIN:0", "/fragment@46/__overlay__:interrupt-parent:0", "/fragment@46/__overlay__:deb-gpios:0", "/fragment@47/__overlay__:interrupt-parent:0", "/fragment@48/__overlay__:interrupt-parent:0", "/fragment@49/__overlay__:interrupt-parent:0", "/fragment@50/__overlay__:interrupt-parent:0", "/fragment@51/__overlay__:interrupt-parent:0", "/fragment@63:target:0", "/fragment@65:target:0";
		pmic_clock_buffer_ctrl = "/fragment@33:target:0";
		spi0 = "/fragment@29:target:0";
		spi2 = "/fragment@15:target:0";
		touch = "/fragment@16:target:0", "/fragment@47:target:0", "/fragment@61:target:0";
	};

	__local_fixups__ {

		fragment@11 {

			__overlay__ {
				pinctrl-0 = <0x0>;
				pinctrl-1 = <0x0>;
				pinctrl-2 = <0x0>;
			};
		};

		fragment@16 {

			__overlay__ {
				pinctrl-0 = <0x0>;
				pinctrl-1 = <0x0>;
				pinctrl-2 = <0x0>;
				pinctrl-3 = <0x0>;
				pinctrl-4 = <0x0>;
				pinctrl-5 = <0x0>;
			};
		};

		fragment@18 {

			__overlay__ {
				pinctrl-0 = <0x0>;
			};
		};

		fragment@20 {

			__overlay__ {
				pinctrl-0 = <0x0>;
				pinctrl-1 = <0x0>;
			};
		};

		fragment@23 {

			__overlay__ {
				pinctrl-0 = <0x0>;
				pinctrl-1 = <0x0>;
				pinctrl-2 = <0x0>;
				pinctrl-3 = <0x0>;
			};
		};

		fragment@24 {

			__overlay__ {
				pinctrl-0 = <0x0>;
				pinctrl-1 = <0x0>;
				pinctrl-2 = <0x0>;
				pinctrl-3 = <0x0>;
				pinctrl-4 = <0x0>;
				pinctrl-5 = <0x0>;
				pinctrl-6 = <0x0>;
				pinctrl-7 = <0x0>;
				pinctrl-8 = <0x0>;
				pinctrl-9 = <0x0>;
			};
		};

		fragment@28 {

			__overlay__ {
				pinctrl-0 = <0x0>;
				pinctrl-1 = <0x0>;
				pinctrl-2 = <0x0>;
				pinctrl-3 = <0x0>;
				pinctrl-4 = <0x0>;
			};
		};

		fragment@29 {

			__overlay__ {

				fingerprint@0 {
					pinctrl-0 = <0x0>;
					pinctrl-1 = <0x0>;
					pinctrl-2 = <0x0>;
					pinctrl-3 = <0x0>;
					pinctrl-4 = <0x0>;
				};
			};
		};

		fragment@64 {

			__overlay__ {
				pinctrl-0 = <0x0>;
				pinctrl-1 = <0x0>;
				pinctrl-10 = <0x0>;
				pinctrl-11 = <0x0>;
				pinctrl-12 = <0x0>;
				pinctrl-13 = <0x0>;
				pinctrl-14 = <0x0>;
				pinctrl-15 = <0x0>;
				pinctrl-16 = <0x0>;
				pinctrl-17 = <0x0>;
				pinctrl-18 = <0x0>;
				pinctrl-2 = <0x0>;
				pinctrl-3 = <0x0>;
				pinctrl-4 = <0x0>;
				pinctrl-5 = <0x0>;
				pinctrl-6 = <0x0>;
				pinctrl-7 = <0x0>;
				pinctrl-8 = <0x0>;
				pinctrl-9 = <0x0>;
			};
		};

		fragment@66 {

			__overlay__ {
				pinctrl-0 = <0x0>;
				pinctrl-1 = <0x0>;
				pinctrl-2 = <0x0>;
			};
		};

		fragment@67 {

			__overlay__ {
				pinctrl-0 = <0x0>;
				pinctrl-1 = <0x0>;
				pinctrl-2 = <0x0>;
			};
		};

		fragment@9 {

			__overlay__ {
				pinctrl-0 = <0x0>;
				pinctrl-1 = <0x0>;
				pinctrl-2 = <0x0>;
				pinctrl-3 = <0x0>;
				pinctrl-4 = <0x0>;
				pinctrl-5 = <0x0>;
				pinctrl-6 = <0x0>;
			};
		};
	};

	__symbols__ {
		accdet_pins_default = "/fragment@21/__overlay__/accdetdefault";
		accdet_pins_eint_as_int = "/fragment@21/__overlay__/accdeteint@0";
		alsps_mtk = "/fragment@35/__overlay__/alsps@23";
		aud_clk_miso_off = "/fragment@25/__overlay__/aud_clk_miso_off";
		aud_clk_miso_on = "/fragment@25/__overlay__/aud_clk_miso_on";
		aud_clk_mosi_off = "/fragment@25/__overlay__/aud_clk_mosi_off";
		aud_clk_mosi_on = "/fragment@25/__overlay__/aud_clk_mosi_on";
		aud_dat_miso_off = "/fragment@25/__overlay__/aud_dat_miso_off";
		aud_dat_miso_on = "/fragment@25/__overlay__/aud_dat_miso_on";
		aud_dat_mosi_off = "/fragment@25/__overlay__/aud_dat_mosi_off";
		aud_dat_mosi_on = "/fragment@25/__overlay__/aud_dat_mosi_on";
		aud_pins_extamp_high = "/fragment@25/__overlay__/audexamphigh";
		aud_pins_extamp_low = "/fragment@25/__overlay__/audexamplow";
		camera_main_af_mtk = "/fragment@36/__overlay__/camera_main_af@72";
		camera_main_mtk = "/fragment@36/__overlay__/camera_main@1a";
		camera_pins_cam0_mclk_off = "/fragment@63/__overlay__/camera_pins_cam0_mclk_off";
		camera_pins_cam0_mclk_on = "/fragment@63/__overlay__/camera_pins_cam0_mclk_on";
		camera_pins_cam0_pnd0 = "/fragment@63/__overlay__/cam0@2";
		camera_pins_cam0_pnd1 = "/fragment@63/__overlay__/cam0@3";
		camera_pins_cam0_rst0 = "/fragment@63/__overlay__/cam0@0";
		camera_pins_cam0_rst1 = "/fragment@63/__overlay__/cam0@1";
		camera_pins_cam1_mclk_off = "/fragment@63/__overlay__/camera_pins_cam1_mclk_off";
		camera_pins_cam1_mclk_on = "/fragment@63/__overlay__/camera_pins_cam1_mclk_on";
		camera_pins_cam1_pnd0 = "/fragment@63/__overlay__/cam1@2";
		camera_pins_cam1_pnd1 = "/fragment@63/__overlay__/cam1@3";
		camera_pins_cam1_rst0 = "/fragment@63/__overlay__/cam1@0";
		camera_pins_cam1_rst1 = "/fragment@63/__overlay__/cam1@1";
		camera_pins_cam2_mclk_off = "/fragment@63/__overlay__/camera_pins_cam2_mclk_off";
		camera_pins_cam2_mclk_on = "/fragment@63/__overlay__/camera_pins_cam2_mclk_on";
		camera_pins_cam2_pnd0 = "/fragment@63/__overlay__/cam2@2";
		camera_pins_cam2_pnd1 = "/fragment@63/__overlay__/cam2@3";
		camera_pins_cam2_rst0 = "/fragment@63/__overlay__/cam2@0";
		camera_pins_cam2_rst1 = "/fragment@63/__overlay__/cam2@1";
		camera_pins_default = "/fragment@63/__overlay__/camdefault";
		camera_sub_mtk = "/fragment@38/__overlay__/camera_sub@2d";
		charger_led_default = "/fragment@10/__overlay__/charger_led_default";
		charger_led_disable = "/fragment@10/__overlay__/charger_led_disable";
		charger_led_enable = "/fragment@10/__overlay__/charger_led_enable";
		consys_pins_default = "/fragment@22/__overlay__/consys_default";
		ctp_pins_default = "/fragment@17/__overlay__/eint0default";
		ctp_pins_eint_as_int = "/fragment@17/__overlay__/eint@0";
		ctp_pins_eint_output0 = "/fragment@17/__overlay__/eintoutput0";
		ctp_pins_eint_output1 = "/fragment@17/__overlay__/eintoutput1";
		ctp_pins_rst_output0 = "/fragment@17/__overlay__/rstoutput0";
		ctp_pins_rst_output1 = "/fragment@17/__overlay__/rstoutput1";
		ext_buck_lp4_mtk = "/fragment@37/__overlay__/ext_buck_lp4@57";
		ext_buck_lp4x_mtk = "/fragment@37/__overlay__/ext_buck_lp4x@50";
		fingerprint_default = "/fragment@30/__overlay__/fingerprint_default";
		fingerprint_eint = "/fragment@30/__overlay__/gpio8_eint";
		fingerprint_eint_pull_down = "/fragment@30/__overlay__/gpio8_eint_pull_down";
		fingerprint_rst_one = "/fragment@30/__overlay__/rst_out_one";
		fingerprint_rst_zero = "/fragment@30/__overlay__/rst_out_zero";
		flashlight_pins_default = "/fragment@27/__overlay__/flashlightdefault";
		flashlight_pins_en_flash_high = "/fragment@27/__overlay__/camled0@3";
		flashlight_pins_en_flash_low = "/fragment@27/__overlay__/camled0@4";
		flashlight_pins_en_torch_high = "/fragment@27/__overlay__/camled0@1";
		flashlight_pins_en_torch_low = "/fragment@27/__overlay__/camled0@2";
		flashlights_aw36515_pins_default = "/fragment@65/__overlay__/aw36515default";
		flashlights_aw36515_pins_hwen_high = "/fragment@65/__overlay__/aw36515hwen_high";
		flashlights_aw36515_pins_hwen_low = "/fragment@65/__overlay__/aw36515hwen_low";
		flashlights_ocp81375_pins_default = "/fragment@65/__overlay__/ocp81375default";
		flashlights_ocp81375_pins_hwen_high = "/fragment@65/__overlay__/ocp81375hwen_high";
		flashlights_ocp81375_pins_hwen_low = "/fragment@65/__overlay__/ocp81375hwen_low";
		gpslna_pins_init = "/fragment@22/__overlay__/gpslna@0";
		gpslna_pins_oh = "/fragment@22/__overlay__/gpslna@1";
		gpslna_pins_ol = "/fragment@22/__overlay__/gpslna@2";
		gsensor_mtk = "/fragment@35/__overlay__/gsensor@15";
		i2c_lcd_bias_mtk = "/fragment@39/__overlay__/i2c_lcd_bias@3e";
		kpd_pins_default = "/fragment@19/__overlay__/kpdgpiodefault";
		led0 = "/fragment@1/__overlay__/led@0";
		led1 = "/fragment@1/__overlay__/led@1";
		led2 = "/fragment@1/__overlay__/led@2";
		led3 = "/fragment@1/__overlay__/led@3";
		led4 = "/fragment@1/__overlay__/led@4";
		led5 = "/fragment@1/__overlay__/led@5";
		led6 = "/fragment@1/__overlay__/led@6";
		mtkfb_pins_default = "/fragment@8/__overlay__/dispdefault";
		mtkfb_pins_lcd_bias_enn0 = "/fragment@8/__overlay__/lcd_bias_enn0_gpio";
		mtkfb_pins_lcd_bias_enn1 = "/fragment@8/__overlay__/lcd_bias_enn1_gpio";
		mtkfb_pins_lcd_bias_enp0 = "/fragment@8/__overlay__/lcd_bias_enp0_gpio";
		mtkfb_pins_lcd_bias_enp1 = "/fragment@8/__overlay__/lcd_bias_enp1_gpio";
		mtkfb_pins_lcm_reset0 = "/fragment@8/__overlay__/lcm_rst_out0_gpio";
		mtkfb_pins_lcm_reset1 = "/fragment@8/__overlay__/lcm_rst_out1_gpio";
		regulator_vibrator = "/fragment@1/__overlay__/regulator_vibrator";
		strobe_main_mtk = "/fragment@39/__overlay__/strobe_main@63";
		tran_touch = "/fragment@15/__overlay__/touch@0";
		vibrator0 = "/fragment@1/__overlay__/vibrator@0";
	};

	fragment@0 {
		target = <0xffffffff>;

		__overlay__ {
			atag,videolfb-fb_base_h = <0x0>;
			atag,videolfb-fb_base_l = "^`P";
			atag,videolfb-fps = <0x1770>;
			atag,videolfb-islcm_inited = <0x0>;
			atag,videolfb-islcmfound = <0x1>;
			atag,videolfb-lcmname = "nt36528_hdp_dsi_vdo_txd_panda_be8";
			atag,videolfb-vramSize = <0x17bb000>;
		};
	};

	fragment@1 {
		target = <0xffffffff>;

		__overlay__ {

			led@0 {
				compatible = "mediatek,red";
				data = <0x1>;
				led_mode = <0x0>;
				phandle = <0x45>;
				pwm_config = <0x0 0x0 0x0 0x0 0x0>;
			};

			led@1 {
				compatible = "mediatek,green";
				data = <0x1>;
				led_mode = <0x0>;
				phandle = <0x46>;
				pwm_config = <0x0 0x0 0x0 0x0 0x0>;
			};

			led@2 {
				compatible = "mediatek,blue";
				data = <0x1>;
				led_mode = <0x0>;
				phandle = <0x47>;
				pwm_config = <0x0 0x0 0x0 0x0 0x0>;
			};

			led@3 {
				compatible = "mediatek,jogball-backlight";
				data = <0x1>;
				led_mode = <0x0>;
				phandle = <0x48>;
				pwm_config = <0x0 0x0 0x0 0x0 0x0>;
			};

			led@4 {
				compatible = "mediatek,keyboard-backlight";
				data = <0x1>;
				led_mode = <0x0>;
				phandle = <0x49>;
				pwm_config = <0x0 0x0 0x0 0x0 0x0>;
			};

			led@5 {
				compatible = "mediatek,button-backlight";
				data = <0x1>;
				led_mode = <0x0>;
				phandle = <0x4a>;
				pwm_config = <0x0 0x0 0x0 0x0 0x0>;
			};

			led@6 {
				compatible = "mediatek,lcd-backlight";
				data = <0x1>;
				led_mode = <0x4>;
				phandle = <0x4b>;
				pwm_config = <0x1 0x0 0x0 0x0 0x0>;
			};

			regulator_vibrator {
				compatible = "regulator-vibrator";
				max-limit = <0x3a98>;
				max-volt = <0x325aa0>;
				min-limit = <0xf>;
				min-volt = <0x325aa0>;
				phandle = <0x4d>;
				vib-supply = <0xffffffff>;
			};

			vibrator@0 {
				compatible = "mediatek,vibrator";
				phandle = <0x4c>;
				vib_limit = <0x9>;
				vib_timer = <0x19>;
				vib_vol = <0xd>;
			};
		};
	};

	fragment@10 {
		target = <0xffffffff>;

		__overlay__ {

			charger_led_default {
				phandle = <0x8>;
			};

			charger_led_disable {
				phandle = <0xa>;

				pins_cmd_dat {
					output-high;
					pinmux = <0x9600>;
					slew-rate = <0x1>;
				};
			};

			charger_led_enable {
				phandle = <0x9>;

				pins_cmd_dat {
					output-low;
					pinmux = <0x9600>;
					slew-rate = <0x1>;
				};
			};
		};
	};

	fragment@11 {
		target = <0xffffffff>;

		__overlay__ {
			pinctrl-0 = <0x8>;
			pinctrl-1 = <0x9>;
			pinctrl-2 = <0xa>;
			pinctrl-names = "charger_led_default", "charger_led_enable", "charger_led_disable";
		};
	};

	fragment@12 {
		target = <0xffffffff>;

		__overlay__ {
			charger = <0xffffffff>;
		};
	};

	fragment@13 {
		target = <0xffffffff>;

		__overlay__ {
			charger = <0xffffffff>;
		};
	};

	fragment@14 {
		target = <0xffffffff>;

		__overlay__ {
			bc12_active = <0x1>;
		};
	};

	fragment@15 {
		target = <0xffffffff>;

		__overlay__ {
			#address-cells = <0x1>;
			#size-cells = <0x0>;
			status = "okay";

			touch@0 {
				compatible = "novatek,NVT-ts-spi", "focaltech,fts";
				novatek,irq-gpio = <0xffffffff 0x4 0x0>;
				novatek,mp-support-dt;
				novatek,reset-gpio = <0xffffffff 0xae 0x0>;
				novatek,spi-rd-fast-addr = <0x3f310>;
				novatek,swrst-n8-addr = <0x3f0fe>;
				phandle = <0x4e>;
				reg = <0x0>;
				spi-max-frequency = <0x7a1200>;
				status = "okay";

				novatek-mp-criteria-6282@0 {
					#address-cells = <0x1>;
					#size-cells = <0x0>;
					AIN_KEY = <0x0 0x1 0x2 0xff>;
					AIN_X = <0x0 0x1 0x2 0x3 0x4 0x5 0x6 0x7 0x8 0x9 0xa 0xb 0xc 0xd 0xe 0xf 0x10 0x11>;
					AIN_Y = <0x0 0x1 0x2 0x3 0x4 0x5 0x6 0x7 0x8 0x9 0xa 0xb 0xc 0xd 0xe 0xf 0x10 0x11 0x12 0x13 0x14 0x15 0x16 0x17 0x18 0x19 0x1a 0x1b 0x1c 0x1d 0x1e 0x1f>;
					IC_KEY_CFG_SIZE = <0x4>;
					IC_X_CFG_SIZE = <0x12>;
					IC_Y_CFG_SIZE = <0x20>;
					PS_Config_Diff_Test_Frame = <0x32>;
					PS_Config_Lmt_FW_CC_N = <0xffff0001 0x34 0x33 0x30 0x30 0x30 0x2f 0x2f 0x2f 0x2f 0x2f 0x30 0x30 0x30 0x30 0x33 0x34 0xffff0001 0x34 0x34 0x31 0x2f 0x2f 0x2f 0x2f 0x2f 0x2f 0x2f 0x2f 0x2f 0x2f 0x2f 0x30 0x32 0x33 0x34 0x34 0x33 0x31 0x2f 0x2f 0x2f 0x2f 0x2f 0x2f 0x2f 0x30 0x2f 0x2f 0x30 0x30 0x32 0x33 0x34 0x34 0x33 0x31 0x2f 0x2f 0x2f 0x2f 0x2f 0x2f 0x2f 0x2f 0x2f 0x2f 0x2f 0x30 0x32 0x33 0x34 0x35 0x33 0x32 0x30 0x30 0x30 0x30 0x30 0x30 0x2f 0x30 0x30 0x2f 0x30 0x30 0x32 0x33 0x35 0x34 0x32 0x31 0x2f 0x2f 0x2f 0x2f 0x2f 0x2f 0x30 0x30 0x30 0x30 0x30 0x30 0x32 0x33 0x34 0x34 0x33 0x32 0x30 0x30 0x30 0x30 0x30 0x30 0x30 0x31 0x30 0x30 0x30 0x31 0x32 0x34 0x35 0x34 0x33 0x31 0x30 0x30 0x2f 0x30 0x30 0x30 0x30 0x30 0x30 0x30 0x30 0x30 0x32 0x33 0x34 0x34 0x33 0x32 0x30 0x30 0x30 0x30 0x30 0x30 0x30 0x30 0x30 0x30 0x30 0x30 0x31 0x33 0x34 0x34 0x32 0x31 0x30 0x30 0x30 0x30 0x30 0x30 0x30 0x2f 0x30 0x30 0x30 0x30 0x31 0x32 0x34 0x34 0x32 0x31 0x2f 0x2f 0x2f 0x2f 0x2f 0x2f 0x30 0x30 0x30 0x30 0x30 0x30 0x32 0x34 0x35 0x34 0x32 0x30 0x2f 0x2f 0x2f 0x2f 0x2f 0x2f 0x30 0x30 0x30 0x30 0x30 0x30 0x31 0x33 0x34 0x34 0x32 0x30 0x2f 0x2f 0x2f 0x2f 0x2f 0x2f 0x30 0x30 0x30 0x30 0x30 0x30 0x30 0x32 0x34 0x34 0x32 0x31 0x30 0x30 0x30 0x30 0x30 0x30 0x30 0x30 0x30 0x30 0x30 0x30 0x31 0x32 0x34 0x34 0x32 0x30 0x2f 0x2f 0x2f 0x2f 0x2f 0x30 0x30 0x30 0x30 0x30 0x30 0x2f 0x30 0x32 0x34 0x34 0x32 0x30 0x30 0x30 0x30 0x30 0x30 0x30 0x30 0x30 0x30 0x30 0x30 0x30 0x30 0x32 0x34 0x35 0x34 0x32 0x31 0x31 0x31 0x31 0x31 0x32 0x31 0x31 0x31 0x31 0x31 0x31 0x32 0x33 0x34 0x35 0x33 0x31 0x30 0x30 0x30 0x30 0x31 0x31 0x31 0x31 0x31 0x31 0x31 0x31 0x32 0x33 0x35 0x34 0x33 0x32 0x30 0x30 0x30 0x30 0x30 0x31 0x31 0x30 0x31 0x31 0x31 0x31 0x32 0x33 0x34 0x35 0x34 0x32 0x31 0x31 0x31 0x31 0x31 0x32 0x32 0x32 0x32 0x32 0x32 0x32 0x32 0x34 0x35 0x34 0x33 0x32 0x31 0x31 0x31 0x31 0x31 0x31 0x32 0x31 0x31 0x32 0x32 0x32 0x32 0x34 0x35 0x35 0x34 0x32 0x32 0x31 0x31 0x31 0x31 0x32 0x32 0x31 0x31 0x32 0x32 0x32 0x32 0x34 0x35 0x35 0x34 0x32 0x32 0x31 0x31 0x31 0x31 0x32 0x32 0x31 0x32 0x32 0x32 0x32 0x32 0x34 0x35 0x35 0x34 0x32 0x32 0x32 0x31 0x31 0x31 0x32 0x32 0x31 0x31 0x31 0x32 0x32 0x32 0x34 0x35 0x34 0x33 0x32 0x31 0x31 0x31 0x31 0x31 0x31 0x32 0x31 0x31 0x31 0x31 0x32 0x32 0x34 0x35 0x35 0x34 0x32 0x32 0x31 0x31 0x31 0x31 0x32 0x32 0x31 0x31 0x31 0x31 0x32 0x32 0x33 0x35 0x35 0x34 0x32 0x32 0x32 0x32 0x32 0x32 0x32 0x32 0x31 0x31 0x32 0x32 0x32 0x32 0x34 0x35 0x35 0x34 0x32 0x32 0x32 0x32 0x32 0x32 0x32 0x32 0x32 0x32 0x32 0x32 0x32 0x32 0x34 0x35 0x34 0x34 0x32 0x32 0x31 0x31 0x31 0x31 0x32 0x32 0x32 0x32 0x32 0x32 0x32 0x32 0x34 0x34 0x34 0x34 0x32 0x32 0x31 0x31 0x31 0x31 0x32 0x32 0x31 0x31 0x32 0x32 0x32 0x32 0x34 0x34 0x33 0x33 0x32 0x32 0x31 0x31 0x31 0x31 0x32 0x32 0x32 0x32 0x32 0x32 0x32 0x32 0x34 0x34 0x34 0x33 0x32 0x32 0x32 0x32 0x32 0x32 0x32 0x33 0x32 0x32 0x32 0x32 0x32 0x32 0x34 0x34 0x0 0x0 0x0>;
					PS_Config_Lmt_FW_CC_P = <0xffff 0x73 0x72 0x6d 0x6d 0x6d 0x6a 0x6a 0x6a 0x6a 0x6a 0x6b 0x6d 0x6d 0x6d 0x72 0x75 0xffff 0x75 0x73 0x6e 0x6a 0x6a 0x6a 0x6a 0x6a 0x6a 0x6a 0x6a 0x6a 0x6a 0x6a 0x6b 0x6f 0x72 0x75 0x75 0x72 0x6e 0x6a 0x6a 0x6a 0x6a 0x6a 0x6a 0x6a 0x6b 0x6a 0x6a 0x6b 0x6b 0x6f 0x72 0x75 0x75 0x72 0x6e 0x6a 0x6a 0x6a 0x6a 0x6a 0x6a 0x6a 0x6a 0x6a 0x6a 0x6a 0x6b 0x6f 0x72 0x75 0x78 0x72 0x6f 0x6b 0x6b 0x6b 0x6b 0x6b 0x6b 0x6a 0x6b 0x6b 0x6a 0x6b 0x6b 0x6f 0x72 0x76 0x73 0x71 0x6e 0x6a 0x6a 0x6a 0x6a 0x6a 0x6a 0x6b 0x6b 0x6b 0x6b 0x6b 0x6d 0x6f 0x72 0x75 0x75 0x72 0x6f 0x6b 0x6b 0x6b 0x6b 0x6b 0x6b 0x6d 0x6e 0x6d 0x6d 0x6d 0x6e 0x71 0x73 0x78 0x75 0x72 0x6e 0x6b 0x6b 0x6a 0x6b 0x6b 0x6b 0x6d 0x6b 0x6b 0x6b 0x6b 0x6b 0x6f 0x72 0x75 0x75 0x72 0x6f 0x6d 0x6b 0x6b 0x6b 0x6b 0x6b 0x6b 0x6b 0x6b 0x6b 0x6b 0x6b 0x6e 0x72 0x75 0x73 0x71 0x6e 0x6b 0x6b 0x6b 0x6b 0x6b 0x6b 0x6b 0x6a 0x6b 0x6b 0x6b 0x6b 0x6e 0x71 0x73 0x73 0x71 0x6e 0x6a 0x6a 0x6a 0x6a 0x6a 0x6a 0x6d 0x6d 0x6d 0x6d 0x6d 0x6d 0x6f 0x73 0x76 0x73 0x71 0x6d 0x6a 0x6a 0x6a 0x6a 0x6a 0x6a 0x6d 0x6b 0x6b 0x6b 0x6b 0x6d 0x6e 0x72 0x75 0x73 0x71 0x6d 0x6a 0x6a 0x6a 0x6a 0x6a 0x6a 0x6b 0x6b 0x6b 0x6b 0x6b 0x6b 0x6d 0x71 0x73 0x75 0x71 0x6e 0x6b 0x6b 0x6b 0x6b 0x6b 0x6d 0x6b 0x6b 0x6b 0x6b 0x6b 0x6b 0x6e 0x71 0x75 0x73 0x71 0x6d 0x6a 0x6a 0x6a 0x6a 0x6a 0x6b 0x6b 0x6b 0x6b 0x6b 0x6b 0x6a 0x6d 0x71 0x73 0x75 0x71 0x6d 0x6b 0x6b 0x6b 0x6b 0x6b 0x6d 0x6b 0x6b 0x6b 0x6b 0x6b 0x6b 0x6d 0x71 0x75 0x76 0x73 0x6f 0x6e 0x6e 0x6e 0x6e 0x6e 0x6f 0x6e 0x6e 0x6e 0x6e 0x6e 0x6e 0x6f 0x72 0x75 0x76 0x72 0x6e 0x6d 0x6d 0x6d 0x6d 0x6e 0x6e 0x6e 0x6e 0x6e 0x6e 0x6e 0x6e 0x6f 0x72 0x76 0x75 0x72 0x6f 0x6d 0x6d 0x6d 0x6d 0x6d 0x6e 0x6e 0x6d 0x6e 0x6e 0x6e 0x6e 0x6f 0x72 0x75 0x76 0x73 0x6f 0x6e 0x6e 0x6e 0x6e 0x6e 0x6f 0x6f 0x6f 0x6f 0x6f 0x6f 0x6f 0x71 0x75 0x78 0x75 0x72 0x6f 0x6e 0x6e 0x6e 0x6e 0x6e 0x6e 0x6f 0x6e 0x6e 0x6f 0x6f 0x6f 0x6f 0x73 0x76 0x76 0x73 0x6f 0x6f 0x6e 0x6e 0x6e 0x6e 0x6f 0x6f 0x6e 0x6e 0x6f 0x6f 0x6f 0x6f 0x73 0x76 0x78 0x73 0x6f 0x6f 0x6e 0x6e 0x6e 0x6e 0x6f 0x6f 0x6e 0x6f 0x6f 0x6f 0x6f 0x71 0x73 0x78 0x76 0x73 0x6f 0x6f 0x6f 0x6e 0x6e 0x6e 0x6f 0x6f 0x6e 0x6e 0x6e 0x6f 0x6f 0x6f 0x73 0x76 0x75 0x72 0x6f 0x6e 0x6e 0x6e 0x6e 0x6e 0x6e 0x6f 0x6e 0x6e 0x6e 0x6e 0x6f 0x6f 0x73 0x76 0x76 0x73 0x6f 0x6f 0x6e 0x6e 0x6e 0x6e 0x6f 0x6f 0x6e 0x6e 0x6e 0x6e 0x6f 0x6f 0x72 0x76 0x78 0x75 0x71 0x6f 0x6f 0x6f 0x6f 0x6f 0x71 0x6f 0x6e 0x6e 0x6f 0x6f 0x6f 0x6f 0x73 0x76 0x76 0x73 0x71 0x6f 0x6f 0x6f 0x6f 0x6f 0x6f 0x6f 0x6f 0x6f 0x6f 0x6f 0x6f 0x71 0x73 0x76 0x73 0x73 0x6f 0x6f 0x6e 0x6e 0x6e 0x6e 0x6f 0x71 0x6f 0x6f 0x6f 0x6f 0x6f 0x71 0x73 0x75 0x73 0x73 0x6f 0x6f 0x6e 0x6e 0x6e 0x6e 0x6f 0x71 0x6e 0x6e 0x6f 0x6f 0x6f 0x6f 0x73 0x75 0x72 0x72 0x6f 0x6f 0x6e 0x6e 0x6e 0x6e 0x6f 0x71 0x6f 0x6f 0x6f 0x6f 0x6f 0x71 0x73 0x73 0x73 0x72 0x71 0x6f 0x6f 0x6f 0x6f 0x6f 0x71 0x72 0x71 0x71 0x71 0x71 0x71 0x71 0x73 0x75 0x13a 0x13a 0x13a>;
					PS_Config_Lmt_FW_Diff_N = <0xffff0001 0xffffffce 0xffffffce 0xffffffce 0xffffffce 0xffffffce 0xffffffce 0xffffffce 0xffffffce 0xffffffce 0xffffffce 0xffffffce 0xffffffce 0xffffffce 0xffffffce 0xffffffce 0xffffffce 0xffff0001 0xffffffce 0xffffffce 0xffffffce 0xffffffce 0xffffffce 0xffffffce 0xffffffce 0xffffffce 0xffffffce 0xffffffce 0xffffffce 0xffffffce 0xffffffce 0xffffffce 0xffffffce 0xffffffce 0xffffffce 0xffffffce 0xffffffce 0xffffffce 0xffffffce 0xffffffce 0xffffffce 0xffffffce 0xffffffce 0xffffffce 0xffffffce 0xffffffce 0xffffffce 0xffffffce 0xffffffce 0xffffffce 0xffffffce 0xffffffce 0xffffffce 0xffffffce 0xffffffce 0xffffffce 0xffffffce 0xffffffce 0xffffffce 0xffffffce 0xffffffce 0xffffffce 0xffffffce 0xffffffce 0xffffffce 0xffffffce 0xffffffce 0xffffffce 0xffffffce 0xffffffce 0xffffffce 0xffffffce 0xffffffce 0xffffffce 0xffffffce 0xffffffce 0xffffffce 0xffffffce 0xffffffce 0xffffffce 0xffffffce 0xffffffce 0xffffffce 0xffffffce 0xffffffce 0xffffffce 0xffffffce 0xffffffce 0xffffffce 0xffffffce 0xffffffce 0xffffffce 0xffffffce 0xffffffce 0xffffffce 0xffffffce 0xffffffce 0xffffffce 0xffffffce 0xffffffce 0xffffffce 0xffffffce 0xffffffce 0xffffffce 0xffffffce 0xffffffce 0xffffffce 0xffffffce 0xffffffce 0xffffffce 0xffffffce 0xffffffce 0xffffffce 0xffffffce 0xffffffce 0xffffffce 0xffffffce 0xffffffce 0xffffffce 0xffffffce 0xffffffce 0xffffffce 0xffffffce 0xffffffce 0xffffffce 0xffffffce 0xffffffce 0xffffffce 0xffffffce 0xffffffce 0xffffffce 0xffffffce 0xffffffce 0xffffffce 0xffffffce 0xffffffce 0xffffffce 0xffffffce 0xffffffce 0xffffffce 0xffffffce 0xffffffce 0xffffffce 0xffffffce 0xffffffce 0xffffffce 0xffffffce 0xffffffce 0xffffffce 0xffffffce 0xffffffce 0xffffffce 0xffffffce 0xffffffce 0xffffffce 0xffffffce 0xffffffce 0xffffffce 0xffffffce 0xffffffce 0xffffffce 0xffffffce 0xffffffce 0xffffffce 0xffffffce 0xffffffce 0xffffffce 0xffffffce 0xffffffce 0xffffffce 0xffffffce 0xffffffce 0xffffffce 0xffffffce 0xffffffce 0xffffffce 0xffffffce 0xffffffce 0xffffffce 0xffffffce 0xffffffce 0xffffffce 0xffffffce 0xffffffce 0xffffffce 0xffffffce 0xffffffce 0xffffffce 0xffffffce 0xffffffce 0xffffffce 0xffffffce 0xffffffce 0xffffffce 0xffffffce 0xffffffce 0xffffffce 0xffffffce 0xffffffce 0xffffffce 0xffffffce 0xffffffce 0xffffffce 0xffffffce 0xffffffce 0xffffffce 0xffffffce 0xffffffce 0xffffffce 0xffffffce 0xffffffce 0xffffffce 0xffffffce 0xffffffce 0xffffffce 0xffffffce 0xffffffce 0xffffffce 0xffffffce 0xffffffce 0xffffffce 0xffffffce 0xffffffce 0xffffffce 0xffffffce 0xffffffce 0xffffffce 0xffffffce 0xffffffce 0xffffffce 0xffffffce 0xffffffce 0xffffffce 0xffffffce 0xffffffce 0xffffffce 0xffffffce 0xffffffce 0xffffffce 0xffffffce 0xffffffce 0xffffffce 0xffffffce 0xffffffce 0xffffffce 0xffffffce 0xffffffce 0xffffffce 0xffffffce 0xffffffce 0xffffffce 0xffffffce 0xffffffce 0xffffffce 0xffffffce 0xffffffce 0xffffffce 0xffffffce 0xffffffce 0xffffffce 0xffffffce 0xffffffce 0xffffffce 0xffffffce 0xffffffce 0xffffffce 0xffffffce 0xffffffce 0xffffffce 0xffffffce 0xffffffce 0xffffffce 0xffffffce 0xffffffce 0xffffffce 0xffffffce 0xffffffce 0xffffffce 0xffffffce 0xffffffce 0xffffffce 0xffffffce 0xffffffce 0xffffffce 0xffffffce 0xffffffce 0xffffffce 0xffffffce 0xffffffce 0xffffffce 0xffffffce 0xffffffce 0xffffffce 0xffffffce 0xffffffce 0xffffffce 0xffffffce 0xffffffce 0xffffffce 0xffffffce 0xffffffce 0xffffffce 0xffffffce 0xffffffce 0xffffffce 0xffffffce 0xffffffce 0xffffffce 0xffffffce 0xffffffce 0xffffffce 0xffffffce 0xffffffce 0xffffffce 0xffffffce 0xffffffce 0xffffffce 0xffffffce 0xffffffce 0xffffffce 0xffffffce 0xffffffce 0xffffffce 0xffffffce 0xffffffce 0xffffffce 0xffffffce 0xffffffce 0xffffffce 0xffffffce 0xffffffce 0xffffffce 0xffffffce 0xffffffce 0xffffffce 0xffffffce 0xffffffce 0xffffffce 0xffffffce 0xffffffce 0xffffffce 0xffffffce 0xffffffce 0xffffffce 0xffffffce 0xffffffce 0xffffffce 0xffffffce 0xffffffce 0xffffffce 0xffffffce 0xffffffce 0xffffffce 0xffffffce 0xffffffce 0xffffffce 0xffffffce 0xffffffce 0xffffffce 0xffffffce 0xffffffce 0xffffffce 0xffffffce 0xffffffce 0xffffffce 0xffffffce 0xffffffce 0xffffffce 0xffffffce 0xffffffce 0xffffffce 0xffffffce 0xffffffce 0xffffffce 0xffffffce 0xffffffce 0xffffffce 0xffffffce 0xffffffce 0xffffffce 0xffffffce 0xffffffce 0xffffffce 0xffffffce 0xffffffce 0xffffffce 0xffffffce 0xffffffce 0xffffffce 0xffffffce 0xffffffce 0xffffffce 0xffffffce 0xffffffce 0xffffffce 0xffffffce 0xffffffce 0xffffffce 0xffffffce 0xffffffce 0xffffffce 0xffffffce 0xffffffce 0xffffffce 0xffffffce 0xffffffce 0xffffffce 0xffffffce 0xffffffce 0xffffffce 0xffffffce 0xffffffce 0xffffffce 0xffffffce 0xffffffce 0xffffffce 0xffffffce 0xffffffce 0xffffffce 0xffffffce 0xffffffce 0xffffffce 0xffffffce 0xffffffce 0xffffffce 0xffffffce 0xffffffce 0xffffffce 0xffffffce 0xffffffce 0xffffffce 0xffffffce 0xffffffce 0xffffffce 0xffffffce 0xffffffce 0xffffffce 0xffffffce 0xffffffce 0xffffffce 0xffffffce 0xffffffce 0xffffffce 0xffffffce 0xffffffce 0xffffffce 0xffffffce 0xffffffce 0xffffffce 0xffffffce 0xffffffce 0xffffffce 0xffffffce 0xffffffce 0xffffffce 0xffffffce 0xffffffce 0xffffffce 0xffffffce 0xffffffce 0xffffffce 0xffffffce 0xffffffce 0xffffffce 0xffffffce 0xffffffce 0xffffffce 0xffffffce 0xffffffce 0xffffffce 0xffffffce 0xffffffce 0xffffffce 0xffffffce 0xffffffce 0xffffffce 0xffffffce 0xffffffce 0xffffffce 0xffffffce 0xffffffce 0xffffffce 0xffffffce 0xffffffce 0xffffffce 0xffffffce 0xffffffce 0xffffffce 0xffffffce 0xffffffce 0xffffffce 0xffffffce 0xffffffce 0xffffffce 0xffffffce 0xffffffce 0xffffffce 0xffffffce 0xffffffce 0xffffffce 0xffffffce 0xffffffce 0xffffffce 0xffffffce 0xffffffce 0xffffffce 0xffffffce 0xffffffce 0xffffffce 0xffffffce 0xffffffce 0xffffffce 0xffffffce 0xffffffce 0xffffffce 0xffffffce 0xffffffce 0xffffffce 0xffffffce 0xffffffce 0xffffffce 0xffffffce 0xffffffce 0xffffffce 0xffffffce 0xffffffce 0xffffffce 0xffffffce 0xffffffce 0xffffffce 0xffffffce 0xffffffce 0xffffffce 0xffffffce 0xffffffce 0xffffffce 0xffffffce 0xffffffce 0xffffffce 0xffffffce 0xffffffce 0xffffffce 0xffffffce 0xffffffce 0xffffffce 0xffffffce 0xffffffce 0xffffffce 0xffffffce 0xffffffce 0xffffffce 0xffffffce 0xffffffce 0xffffffce 0xffffffce 0xffffffce 0xffffffce 0xffffffce 0xffffffce 0xffffffce 0xffffffce 0xffffffce 0xffffffce 0xffffffce 0xffffffce 0xffffffce 0xffffffce 0xffffffce 0xffffffce 0xffffffce 0xffffffce 0xffffffce 0xffffffce 0xffffffce 0xffffffce 0xffffffce 0xffffffb5 0xffffffb5 0xffffffb5>;
					PS_Config_Lmt_FW_Diff_P = <0xffff 0x32 0x32 0x32 0x32 0x32 0x32 0x32 0x32 0x32 0x32 0x32 0x32 0x32 0x32 0x32 0x32 0xffff 0x32 0x32 0x32 0x32 0x32 0x32 0x32 0x32 0x32 0x32 0x32 0x32 0x32 0x32 0x32 0x32 0x32 0x32 0x32 0x32 0x32 0x32 0x32 0x32 0x32 0x32 0x32 0x32 0x32 0x32 0x32 0x32 0x32 0x32 0x32 0x32 0x32 0x32 0x32 0x32 0x32 0x32 0x32 0x32 0x32 0x32 0x32 0x32 0x32 0x32 0x32 0x32 0x32 0x32 0x32 0x32 0x32 0x32 0x32 0x32 0x32 0x32 0x32 0x32 0x32 0x32 0x32 0x32 0x32 0x32 0x32 0x32 0x32 0x32 0x32 0x32 0x32 0x32 0x32 0x32 0x32 0x32 0x32 0x32 0x32 0x32 0x32 0x32 0x32 0x32 0x32 0x32 0x32 0x32 0x32 0x32 0x32 0x32 0x32 0x32 0x32 0x32 0x32 0x32 0x32 0x32 0x32 0x32 0x32 0x32 0x32 0x32 0x32 0x32 0x32 0x32 0x32 0x32 0x32 0x32 0x32 0x32 0x32 0x32 0x32 0x32 0x32 0x32 0x32 0x32 0x32 0x32 0x32 0x32 0x32 0x32 0x32 0x32 0x32 0x32 0x32 0x32 0x32 0x32 0x32 0x32 0x32 0x32 0x32 0x32 0x32 0x32 0x32 0x32 0x32 0x32 0x32 0x32 0x32 0x32 0x32 0x32 0x32 0x32 0x32 0x32 0x32 0x32 0x32 0x32 0x32 0x32 0x32 0x32 0x32 0x32 0x32 0x32 0x32 0x32 0x32 0x32 0x32 0x32 0x32 0x32 0x32 0x32 0x32 0x32 0x32 0x32 0x32 0x32 0x32 0x32 0x32 0x32 0x32 0x32 0x32 0x32 0x32 0x32 0x32 0x32 0x32 0x32 0x32 0x32 0x32 0x32 0x32 0x32 0x32 0x32 0x32 0x32 0x32 0x32 0x32 0x32 0x32 0x32 0x32 0x32 0x32 0x32 0x32 0x32 0x32 0x32 0x32 0x32 0x32 0x32 0x32 0x32 0x32 0x32 0x32 0x32 0x32 0x32 0x32 0x32 0x32 0x32 0x32 0x32 0x32 0x32 0x32 0x32 0x32 0x32 0x32 0x32 0x32 0x32 0x32 0x32 0x32 0x32 0x32 0x32 0x32 0x32 0x32 0x32 0x32 0x32 0x32 0x32 0x32 0x32 0x32 0x32 0x32 0x32 0x32 0x32 0x32 0x32 0x32 0x32 0x32 0x32 0x32 0x32 0x32 0x32 0x32 0x32 0x32 0x32 0x32 0x32 0x32 0x32 0x32 0x32 0x32 0x32 0x32 0x32 0x32 0x32 0x32 0x32 0x32 0x32 0x32 0x32 0x32 0x32 0x32 0x32 0x32 0x32 0x32 0x32 0x32 0x32 0x32 0x32 0x32 0x32 0x32 0x32 0x32 0x32 0x32 0x32 0x32 0x32 0x32 0x32 0x32 0x32 0x32 0x32 0x32 0x32 0x32 0x32 0x32 0x32 0x32 0x32 0x32 0x32 0x32 0x32 0x32 0x32 0x32 0x32 0x32 0x32 0x32 0x32 0x32 0x32 0x32 0x32 0x32 0x32 0x32 0x32 0x32 0x32 0x32 0x32 0x32 0x32 0x32 0x32 0x32 0x32 0x32 0x32 0x32 0x32 0x32 0x32 0x32 0x32 0x32 0x32 0x32 0x32 0x32 0x32 0x32 0x32 0x32 0x32 0x32 0x32 0x32 0x32 0x32 0x32 0x32 0x32 0x32 0x32 0x32 0x32 0x32 0x32 0x32 0x32 0x32 0x32 0x32 0x32 0x32 0x32 0x32 0x32 0x32 0x32 0x32 0x32 0x32 0x32 0x32 0x32 0x32 0x32 0x32 0x32 0x32 0x32 0x32 0x32 0x32 0x32 0x32 0x32 0x32 0x32 0x32 0x32 0x32 0x32 0x32 0x32 0x32 0x32 0x32 0x32 0x32 0x32 0x32 0x32 0x32 0x32 0x32 0x32 0x32 0x32 0x32 0x32 0x32 0x32 0x32 0x32 0x32 0x32 0x32 0x32 0x32 0x32 0x32 0x32 0x32 0x32 0x32 0x32 0x32 0x32 0x32 0x32 0x32 0x32 0x32 0x32 0x32 0x32 0x32 0x32 0x32 0x32 0x32 0x32 0x32 0x32 0x32 0x32 0x32 0x32 0x32 0x32 0x32 0x32 0x32 0x32 0x32 0x32 0x32 0x32 0x32 0x32 0x32 0x32 0x32 0x32 0x32 0x32 0x32 0x32 0x32 0x32 0x32 0x32 0x32 0x32 0x32 0x32 0x32 0x32 0x32 0x32 0x32 0x32 0x32 0x32 0x32 0x32 0x32 0x32 0x32 0x32 0x32 0x32 0x32 0x32 0x32 0x32 0x32 0x32 0x32 0x32 0x32 0x32 0x4b 0x4b 0x4b>;
					PS_Config_Lmt_FW_Rawdata_N = <0xffff0001 0x1dc 0x1e0 0x1e6 0x1e5 0x1de 0x1e5 0x1e4 0x1df 0x1e2 0x1e3 0x1e6 0x1de 0x1e5 0x1e8 0x1e4 0x1df 0xffff0001 0x1dd 0x1e5 0x1e0 0x1e7 0x1e3 0x1de 0x1e1 0x1e0 0x1e3 0x1dd 0x1db 0x1dc 0x1dd 0x1e1 0x1e3 0x1e3 0x1de 0x1de 0x1e4 0x1d8 0x1e0 0x1de 0x1e3 0x1e2 0x1e1 0x1e4 0x1e0 0x1de 0x1e2 0x1e2 0x1e2 0x1e4 0x1e0 0x1e2 0x1de 0x1e2 0x1e1 0x1e1 0x1e4 0x1e7 0x1e0 0x1df 0x1dd 0x1e0 0x1df 0x1e3 0x1e6 0x1e3 0x1e3 0x1e6 0x1e5 0x1d9 0x1dd 0x1dd 0x1db 0x1e1 0x1e0 0x1de 0x1df 0x1e5 0x1e0 0x1db 0x1e3 0x1dc 0x1dd 0x1dd 0x1dc 0x1db 0x1e0 0x1dd 0x1e1 0x1da 0x1e6 0x1e0 0x1e3 0x1e7 0x1e4 0x1e0 0x1e6 0x1e9 0x1e1 0x1e1 0x1df 0x1e2 0x1e1 0x1e1 0x1de 0x1e2 0x1e4 0x1dc 0x1e7 0x1e2 0x1e7 0x1e3 0x1e1 0x1e1 0x1e4 0x1e7 0x1e3 0x1e3 0x1e6 0x1e6 0x1e3 0x1e4 0x1e7 0x1e4 0x1da 0x1dc 0x1d6 0x1e3 0x1e9 0x1e6 0x1e9 0x1e7 0x1e8 0x1e6 0x1e7 0x1e1 0x1e5 0x1e3 0x1e4 0x1e2 0x1e6 0x1e4 0x1e0 0x1e6 0x1de 0x1dd 0x1e4 0x1e7 0x1ec 0x1ec 0x1e7 0x1e4 0x1e8 0x1e1 0x1dd 0x1dd 0x1e2 0x1e4 0x1e2 0x1db 0x1e4 0x1df 0x1dd 0x1e0 0x1df 0x1e0 0x1e1 0x1e3 0x1de 0x1e0 0x1e0 0x1e6 0x1e0 0x1df 0x1e1 0x1e7 0x1e6 0x1e1 0x1e0 0x1e1 0x1e6 0x1e5 0x1e3 0x1e3 0x1e4 0x1e0 0x1de 0x1e1 0x1e4 0x1de 0x1e1 0x1e5 0x1e4 0x1e7 0x1df 0x1e2 0x1e3 0x1d7 0x1e2 0x1e4 0x1e5 0x1e6 0x1e4 0x1e4 0x1e3 0x1e3 0x1e8 0x1dd 0x1e3 0x1e7 0x1e4 0x1e5 0x1e0 0x1e4 0x1e5 0x1e3 0x1db 0x1dd 0x1e7 0x1e3 0x1e3 0x1e2 0x1e0 0x1e3 0x1dd 0x1e2 0x1e4 0x1e1 0x1e3 0x1de 0x1e0 0x1e6 0x1dd 0x1d8 0x1e3 0x1e6 0x1e3 0x1df 0x1e1 0x1e2 0x1e6 0x1e3 0x1df 0x1e5 0x1e4 0x1e4 0x1e4 0x1e6 0x1e8 0x1df 0x1e1 0x1de 0x1e1 0x1de 0x1e7 0x1ea 0x1e6 0x1e6 0x1e4 0x1e3 0x1e1 0x1e5 0x1e3 0x1e0 0x1dd 0x1df 0x1e0 0x1db 0x1e1 0x1e3 0x1d7 0x1e4 0x1e4 0x1de 0x1dd 0x1de 0x1de 0x1e1 0x1dd 0x1de 0x1e0 0x1df 0x1e3 0x1de 0x1e1 0x1e2 0x1d9 0x1e1 0x1e2 0x1e7 0x1e1 0x1eb 0x1e9 0x1ea 0x1ea 0x1ed 0x1e1 0x1eb 0x1e3 0x1ea 0x1e8 0x1e5 0x1e6 0x1db 0x1e0 0x1e3 0x1e0 0x1e2 0x1e1 0x1e9 0x1e3 0x1e6 0x1e6 0x1e2 0x1e4 0x1df 0x1e4 0x1e6 0x1e4 0x1e7 0x1e7 0x1e5 0x1de 0x1e7 0x1e1 0x1e4 0x1e0 0x1df 0x1de 0x1e1 0x1e1 0x1e0 0x1e3 0x1e4 0x1e1 0x1df 0x1de 0x1dd 0x1dc 0x1eb 0x1db 0x1e1 0x1e1 0x1ea 0x1e0 0x1e2 0x1e9 0x1e7 0x1e5 0x1e6 0x1da 0x1e2 0x1e9 0x1e7 0x1ea 0x1e8 0x1e7 0x1e5 0x1e3 0x1e8 0x1dc 0x1de 0x1e3 0x1e1 0x1e3 0x1e4 0x1e8 0x1e6 0x1e7 0x1df 0x1e3 0x1e4 0x1db 0x1da 0x1e3 0x1e4 0x1e0 0x1db 0x1ec 0x1df 0x1e6 0x1e2 0x1e1 0x1e0 0x1de 0x1dd 0x1e4 0x1de 0x1e4 0x1e4 0x1da 0x1de 0x1e1 0x1e6 0x1e4 0x1db 0x1e3 0x1db 0x1ea 0x1e8 0x1e0 0x1e3 0x1e0 0x1e0 0x1ec 0x1dd 0x1e9 0x1e9 0x1ed 0x1e4 0x1e7 0x1de 0x1de 0x1e1 0x1dd 0x1e4 0x1e3 0x1e6 0x1de 0x1e0 0x1e0 0x1e3 0x1e9 0x1e5 0x1e4 0x1e6 0x1e1 0x1e7 0x1e3 0x1de 0x1e1 0x1e0 0x1dd 0x1e3 0x1e4 0x1de 0x1e3 0x1e4 0x1e7 0x1e3 0x1e0 0x1e1 0x1e6 0x1e7 0x1e6 0x1e7 0x1e7 0x1e0 0x1dd 0x1da 0x1dd 0x1da 0x1e1 0x1ea 0x1de 0x1e0 0x1de 0x1df 0x1e4 0x1de 0x1e0 0x1e4 0x1e6 0x1e8 0x1df 0x1e9 0x1db 0x1de 0x1df 0x1e3 0x1db 0x1e1 0x1e9 0x1e8 0x1ed 0x1ee 0x1db 0x1e0 0x1e0 0x1db 0x1dc 0x1dd 0x1e2 0x1e6 0x1e3 0x1dc 0x1e2 0x1e0 0x1e6 0x1e0 0x1de 0x1db 0x1de 0x1dd 0x1e4 0x1e2 0x1e5 0x1e9 0x1e1 0x1e1 0x1e0 0x1e0 0x1e3 0x1e3 0x1da 0x1e3 0x1e9 0x1e0 0x1dd 0x1dd 0x1e1 0x1e3 0x1e3 0x1e0 0x1e3 0x1e1 0x1e6 0x1e6 0x1e9 0x1e0 0x1de 0x1e1 0x1de 0x1df 0x1e8 0x1e3 0x1e0 0x1e1 0x1e1 0x1de 0x1e4 0x1de 0x1e8 0x1e8 0x1ea 0x1e8 0x1e9 0x1db 0x1de 0x1e6 0x1e2 0x1dd 0x1de 0x1ea 0x1e4 0x1e6 0x1e3 0x1e2 0x1de 0x1e0 0x1dd 0x1e0 0x1e5 0x1e3 0x1ec 0x1de 0x1da 0x1e0 0x1e1 0x1e2 0x1e3 0x1de 0x1e0 0x1de 0x1e1 0x1e4 0x1e6 0x1e0 0x1e3 0x1e4 0x1e6 0x1e7 0x1e3 0x1df 0x1de 0x1ea 0xf0 0xf0 0xf0>;
					PS_Config_Lmt_FW_Rawdata_P = <0xffff 0x457 0x461 0x46e 0x46c 0x45d 0x46c 0x46b 0x45e 0x465 0x468 0x46e 0x45d 0x46c 0x473 0x46b 0x45e 0xffff 0x45a 0x46c 0x460 0x470 0x467 0x45d 0x462 0x461 0x467 0x45a 0x454 0x457 0x45a 0x464 0x468 0x468 0x45b 0x45d 0x46b 0x44d 0x460 0x45b 0x468 0x465 0x462 0x469 0x461 0x45d 0x465 0x465 0x465 0x46b 0x461 0x465 0x45d 0x465 0x464 0x462 0x46b 0x470 0x461 0x45e 0x45a 0x460 0x45e 0x468 0x46e 0x468 0x468 0x46f 0x46c 0x450 0x459 0x459 0x454 0x462 0x461 0x45b 0x45e 0x46c 0x460 0x456 0x468 0x457 0x45a 0x45a 0x457 0x456 0x461 0x45a 0x462 0x453 0x46f 0x460 0x467 0x472 0x469 0x460 0x46f 0x475 0x464 0x464 0x45e 0x465 0x464 0x462 0x45d 0x465 0x46b 0x457 0x470 0x465 0x470 0x467 0x462 0x462 0x469 0x472 0x467 0x467 0x46f 0x46f 0x468 0x46b 0x470 0x46b 0x453 0x457 0x449 0x467 0x475 0x46e 0x476 0x472 0x473 0x46e 0x472 0x464 0x46c 0x468 0x469 0x465 0x46f 0x46b 0x461 0x46e 0x45d 0x45a 0x46b 0x472 0x47d 0x47c 0x470 0x46b 0x473 0x464 0x45a 0x45a 0x465 0x469 0x465 0x456 0x469 0x45e 0x459 0x461 0x45e 0x460 0x462 0x468 0x45d 0x461 0x461 0x46e 0x461 0x45e 0x464 0x470 0x46e 0x462 0x460 0x462 0x46e 0x46c 0x468 0x468 0x46b 0x461 0x45b 0x464 0x46b 0x45d 0x462 0x46c 0x469 0x472 0x45e 0x465 0x467 0x44b 0x465 0x469 0x46c 0x46e 0x469 0x46b 0x468 0x467 0x473 0x45a 0x467 0x472 0x469 0x46c 0x461 0x469 0x46c 0x467 0x456 0x459 0x472 0x467 0x467 0x465 0x461 0x468 0x45a 0x465 0x469 0x464 0x467 0x45d 0x460 0x46e 0x45a 0x44d 0x467 0x46f 0x468 0x45e 0x464 0x465 0x46f 0x468 0x45e 0x46c 0x469 0x469 0x469 0x46f 0x473 0x45e 0x462 0x45b 0x464 0x45d 0x470 0x477 0x46e 0x46f 0x46b 0x468 0x462 0x46c 0x467 0x460 0x45a 0x45e 0x461 0x454 0x462 0x468 0x44c 0x46b 0x469 0x45d 0x45a 0x45b 0x45d 0x462 0x459 0x45d 0x461 0x45e 0x468 0x45d 0x462 0x465 0x450 0x464 0x465 0x470 0x462 0x47a 0x475 0x477 0x477 0x47e 0x464 0x47a 0x468 0x479 0x473 0x46c 0x46e 0x454 0x460 0x467 0x460 0x465 0x462 0x475 0x467 0x46f 0x46f 0x465 0x469 0x45e 0x469 0x46f 0x46b 0x470 0x470 0x46c 0x45b 0x472 0x462 0x46b 0x460 0x45e 0x45d 0x464 0x464 0x460 0x467 0x469 0x464 0x45e 0x45d 0x459 0x457 0x47a 0x454 0x462 0x464 0x477 0x460 0x465 0x475 0x472 0x46c 0x46f 0x452 0x465 0x476 0x470 0x477 0x473 0x472 0x46c 0x468 0x473 0x457 0x45b 0x467 0x464 0x468 0x46b 0x473 0x46f 0x472 0x45e 0x467 0x469 0x454 0x452 0x467 0x46b 0x461 0x456 0x47d 0x45e 0x46f 0x465 0x464 0x461 0x45d 0x459 0x46b 0x45b 0x469 0x469 0x453 0x45b 0x462 0x46f 0x46b 0x454 0x468 0x454 0x477 0x473 0x461 0x468 0x461 0x461 0x47d 0x459 0x475 0x476 0x480 0x46b 0x470 0x45d 0x45d 0x462 0x45a 0x46b 0x468 0x46e 0x45b 0x461 0x460 0x467 0x475 0x46c 0x46b 0x46e 0x462 0x470 0x468 0x45d 0x462 0x461 0x459 0x467 0x46b 0x45b 0x467 0x46b 0x470 0x468 0x460 0x464 0x46f 0x470 0x46f 0x472 0x470 0x460 0x45a 0x453 0x459 0x453 0x464 0x477 0x45b 0x460 0x45d 0x45e 0x46b 0x45b 0x461 0x46b 0x46e 0x473 0x45e 0x475 0x456 0x45b 0x45e 0x468 0x456 0x464 0x475 0x473 0x480 0x481 0x456 0x460 0x460 0x456 0x457 0x459 0x465 0x46f 0x467 0x457 0x465 0x461 0x46e 0x461 0x45d 0x456 0x45b 0x45a 0x469 0x465 0x46c 0x476 0x464 0x464 0x461 0x461 0x467 0x467 0x453 0x468 0x475 0x461 0x459 0x459 0x464 0x467 0x467 0x460 0x467 0x464 0x46e 0x46f 0x476 0x461 0x45d 0x462 0x45d 0x45e 0x473 0x468 0x461 0x464 0x464 0x45d 0x469 0x45d 0x473 0x473 0x479 0x473 0x476 0x454 0x45b 0x46e 0x465 0x45a 0x45b 0x477 0x469 0x46f 0x468 0x465 0x45d 0x460 0x45a 0x461 0x46c 0x467 0x47c 0x45b 0x452 0x460 0x462 0x465 0x468 0x45d 0x461 0x45b 0x464 0x46b 0x46e 0x460 0x467 0x469 0x46e 0x470 0x467 0x45e 0x45d 0x477 0xf00 0xf00 0xf00>;
					PS_Config_Lmt_Open_Rawdata_N = <0xffff0001 0x516 0x502 0x4ff 0x4f0 0x4dd 0x4c5 0x4a5 0x484 0x4a5 0x4b8 0x4d5 0x4ec 0x4ff 0x50d 0x506 0x51f 0xffff0001 0x514 0x520 0x517 0x50b 0x501 0x4f7 0x4ec 0x4e0 0x4d1 0x4df 0x4e9 0x4f3 0x4fe 0x507 0x50e 0x51a 0x522 0x509 0x511 0x516 0x50d 0x502 0x4f9 0x4ef 0x4e6 0x4da 0x4c7 0x4e0 0x4ee 0x4f6 0x4ff 0x509 0x511 0x51b 0x523 0x511 0x50b 0x50f 0x506 0x4fc 0x4f3 0x4e7 0x4df 0x4d3 0x4c0 0x4ca 0x4d7 0x4e1 0x4e9 0x4f2 0x4fa 0x505 0x50b 0x4fa 0x522 0x523 0x51a 0x510 0x506 0x4fc 0x4f3 0x4e7 0x4d6 0x4df 0x4ec 0x4f5 0x4fd 0x505 0x50e 0x518 0x520 0x511 0x513 0x516 0x50c 0x502 0x4f8 0x4ef 0x4e5 0x4db 0x4c8 0x4f5 0x502 0x50b 0x514 0x51e 0x525 0x52e 0x536 0x528 0x522 0x524 0x51b 0x510 0x507 0x4fe 0x4f4 0x4ea 0x4d6 0x4e9 0x4f6 0x4ff 0x507 0x510 0x517 0x520 0x529 0x51d 0x51f 0x522 0x518 0x50e 0x505 0x4fc 0x4f2 0x4e8 0x4d4 0x4c7 0x4d4 0x4dd 0x4e6 0x4ed 0x4f5 0x4fe 0x507 0x4fc 0x52d 0x52e 0x525 0x51b 0x513 0x508 0x501 0x4f3 0x4e1 0x4db 0x4e5 0x4ef 0x4f9 0x501 0x508 0x511 0x51a 0x512 0x52e 0x52f 0x525 0x51c 0x513 0x50a 0x4fe 0x4f2 0x4e3 0x4dc 0x4e7 0x4f1 0x4fa 0x504 0x50c 0x516 0x51e 0x517 0x52c 0x52d 0x523 0x51a 0x512 0x506 0x4fc 0x4f0 0x4e2 0x4e6 0x4f1 0x4fb 0x502 0x50c 0x514 0x51d 0x526 0x520 0x526 0x526 0x51d 0x513 0x50a 0x500 0x4f6 0x4ea 0x4db 0x4dc 0x4e6 0x4f0 0x4f9 0x502 0x50a 0x514 0x51d 0x519 0x530 0x531 0x526 0x51c 0x514 0x50a 0x501 0x4f5 0x4e5 0x4de 0x4e9 0x4f3 0x4fb 0x505 0x50d 0x516 0x51f 0x51a 0x534 0x533 0x529 0x520 0x517 0x50d 0x504 0x4fa 0x4e8 0x4e7 0x4f2 0x4fb 0x503 0x50b 0x513 0x51c 0x525 0x523 0x531 0x52e 0x525 0x51c 0x513 0x509 0x500 0x4f5 0x4e4 0x4e6 0x4f0 0x4fb 0x502 0x50b 0x513 0x51b 0x523 0x522 0x535 0x533 0x52b 0x520 0x517 0x50d 0x505 0x4fa 0x4e9 0x4ec 0x4f7 0x500 0x508 0x511 0x519 0x522 0x52a 0x528 0x537 0x534 0x52a 0x522 0x51a 0x510 0x507 0x4fc 0x4ec 0x4f0 0x4fc 0x505 0x50d 0x516 0x51d 0x526 0x52e 0x52c 0x534 0x532 0x528 0x520 0x519 0x510 0x507 0x4fc 0x4ea 0x4ec 0x4f7 0x4ff 0x509 0x511 0x519 0x521 0x52a 0x528 0x532 0x531 0x528 0x51f 0x516 0x50d 0x504 0x4f8 0x4e7 0x4f3 0x500 0x509 0x510 0x519 0x522 0x52a 0x532 0x531 0x538 0x537 0x52c 0x523 0x51c 0x513 0x50a 0x4fe 0x4ed 0x4f2 0x4fe 0x508 0x510 0x517 0x520 0x528 0x531 0x52e 0x534 0x531 0x528 0x51f 0x516 0x50e 0x505 0x4f9 0x4e8 0x4ed 0x4f8 0x501 0x50a 0x512 0x519 0x521 0x529 0x527 0x538 0x537 0x52e 0x527 0x51d 0x514 0x50c 0x4ff 0x4ef 0x4ee 0x4f9 0x504 0x50b 0x514 0x51d 0x525 0x52d 0x52b 0x546 0x543 0x53a 0x532 0x529 0x520 0x518 0x50d 0x4fd 0x4f8 0x505 0x50e 0x516 0x51f 0x527 0x52e 0x537 0x537 0x528 0x528 0x51f 0x516 0x50e 0x505 0x4fd 0x4f2 0x4e1 0x504 0x50f 0x519 0x520 0x529 0x531 0x539 0x541 0x53f 0x53e 0x53d 0x534 0x52c 0x525 0x51b 0x514 0x50a 0x4f9 0x4ef 0x4fb 0x505 0x50c 0x514 0x51c 0x523 0x52c 0x529 0x55f 0x560 0x556 0x54f 0x547 0x53e 0x537 0x52b 0x51a 0x4f6 0x502 0x50c 0x514 0x51c 0x524 0x52c 0x534 0x533 0x54f 0x54f 0x545 0x53d 0x536 0x52d 0x524 0x519 0x50a 0x4f2 0x4fd 0x508 0x510 0x517 0x51f 0x526 0x52f 0x52e 0x55c 0x55e 0x556 0x54d 0x546 0x53d 0x534 0x528 0x515 0x516 0x522 0x52d 0x535 0x53e 0x546 0x54d 0x556 0x555 0x507 0x56d 0x564 0x55c 0x554 0x54a 0x541 0x536 0x525 0x51d 0x52a 0x534 0x53d 0x546 0x54e 0x556 0x55e 0x4f9 0x4f2 0x55b 0x552 0x54a 0x542 0x538 0x531 0x523 0x512 0x516 0x522 0x52c 0x535 0x53e 0x546 0x54e 0x556 0x4f1 0x4ec 0x557 0x54f 0x547 0x53e 0x534 0x52d 0x520 0x510 0x530 0x53b 0x546 0x54f 0x558 0x55f 0x567 0x56e 0x508 0x510 0x552 0x566 0x55e 0x556 0x54c 0x543 0x535 0x526 0x528 0x532 0x541 0x54d 0x55b 0x565 0x56e 0x55e 0x51c 0xfffffe01 0xfffffe01 0xfffffe01>;
					PS_Config_Lmt_Open_Rawdata_P = <0xffff 0xbde 0xbaf 0xba8 0xb87 0xb59 0xb21 0xad8 0xa89 0xad8 0xb03 0xb46 0xb7c 0xba8 0xbca 0xbb9 0xbf4 0xffff 0xbdb 0xbf5 0xbe2 0xbc4 0xbae 0xb96 0xb7d 0xb61 0xb3d 0xb5e 0xb76 0xb8e 0xba6 0xbbb 0xbcd 0xbe7 0xbfa 0xbc0 0xbd4 0xbde 0xbca 0xbb1 0xb9a 0xb83 0xb6e 0xb53 0xb26 0xb60 0xb81 0xb95 0xbaa 0xbc0 0xbd2 0xbea 0xbfc 0xbd2 0xbc6 0xbce 0xbb9 0xba1 0xb8c 0xb72 0xb5e 0xb42 0xb17 0xb2d 0xb4c 0xb62 0xb76 0xb8b 0xb9d 0xbb6 0xbc6 0xb9d 0xbfb 0xbfe 0xbe7 0xbd0 0xbb9 0xba3 0xb8c 0xb72 0xb49 0xb5e 0xb7c 0xb92 0xba4 0xbb8 0xbcb 0xbe3 0xbf5 0xbd2 0xbd7 0xbde 0xbc7 0xbaf 0xb99 0xb83 0xb6c 0xb54 0xb29 0xb91 0xbb1 0xbc6 0xbd9 0xbf1 0xc02 0xc16 0xc29 0xc09 0xbfb 0xbff 0xbea 0xbd1 0xbbc 0xba6 0xb8f 0xb79 0xb49 0xb76 0xb95 0xbaa 0xbbc 0xbd1 0xbe2 0xbf5 0xc0a 0xbee 0xbf3 0xbfa 0xbe3 0xbcb 0xbb8 0xba1 0xb8a 0xb73 0xb45 0xb26 0xb44 0xb5a 0xb6f 0xb80 0xb91 0xba7 0xbbc 0xba3 0xc14 0xc16 0xc01 0xbea 0xbd7 0xbbd 0xbad 0xb8c 0xb64 0xb54 0xb6c 0xb83 0xb9a 0xbae 0xbbf 0xbd2 0xbe7 0xbd5 0xc17 0xc18 0xc02 0xbed 0xbd7 0xbc2 0xba7 0xb8b 0xb67 0xb57 0xb72 0xb88 0xb9d 0xbb5 0xbc7 0xbde 0xbf1 0xbe0 0xc13 0xc14 0xbfe 0xbe9 0xbd5 0xbb9 0xba3 0xb87 0xb65 0xb6f 0xb88 0xba0 0xbb1 0xbc7 0xbd9 0xbf0 0xc05 0xbf7 0xc03 0xc03 0xbf0 0xbd8 0xbc2 0xbab 0xb95 0xb79 0xb54 0xb57 0xb6f 0xb87 0xb9c 0xbb1 0xbc3 0xbdb 0xbf0 0xbe5 0xc1b 0xc1d 0xc05 0xbed 0xbd9 0xbc3 0xbad 0xb92 0xb6c 0xb5d 0xb75 0xb8e 0xba0 0xbb6 0xbca 0xbde 0xbf3 0xbe9 0xc25 0xc22 0xc0c 0xbf5 0xbe0 0xbc9 0xbb4 0xb9d 0xb73 0xb70 0xb8a 0xb9f 0xbb2 0xbc6 0xbd8 0xbed 0xc01 0xbfc 0xc1e 0xc17 0xc02 0xbed 0xbd7 0xbc0 0xbab 0xb92 0xb69 0xb6e 0xb87 0xb9f 0xbb1 0xbc6 0xbd7 0xbea 0xbfe 0xbfa 0xc28 0xc22 0xc0f 0xbf7 0xbe2 0xbca 0xbb6 0xb9d 0xb75 0xb7c 0xb96 0xbab 0xbbf 0xbd2 0xbe6 0xbfa 0xc0d 0xc09 0xc2c 0xc25 0xc0d 0xbfb 0xbe7 0xbd0 0xbbb 0xba3 0xb7c 0xb85 0xba3 0xbb8 0xbca 0xbdf 0xbee 0xc03 0xc17 0xc13 0xc24 0xc1f 0xc09 0xbf5 0xbe5 0xbd0 0xbbb 0xba1 0xb79 0xb7c 0xb96 0xbaa 0xbc0 0xbd4 0xbe6 0xbf8 0xc0d 0xc08 0xc21 0xc1d 0xc08 0xbf3 0xbdf 0xbc9 0xbb4 0xb99 0xb72 0xb8e 0xbab 0xbc0 0xbd1 0xbe6 0xbfa 0xc0d 0xc1f 0xc1d 0xc2d 0xc2b 0xc11 0xbfe 0xbed 0xbd7 0xbc2 0xba7 0xb80 0xb8b 0xba7 0xbbf 0xbd0 0xbe2 0xbf7 0xc09 0xc1d 0xc16 0xc24 0xc1e 0xc08 0xbf4 0xbdf 0xbcb 0xbb6 0xb9a 0xb73 0xb7e 0xb98 0xbae 0xbc2 0xbd5 0xbe5 0xbf8 0xc0a 0xc06 0xc2f 0xc2c 0xc17 0xc06 0xbee 0xbd9 0xbc7 0xbaa 0xb83 0xb81 0xb9c 0xbb4 0xbc6 0xbd9 0xbee 0xc01 0xc14 0xc10 0xc4f 0xc48 0xc32 0xc21 0xc0c 0xbf5 0xbe3 0xbc9 0xba4 0xb99 0xbb6 0xbcb 0xbdf 0xbf4 0xc06 0xc17 0xc2b 0xc2b 0xc09 0xc08 0xbf3 0xbdf 0xbcd 0xbb6 0xba4 0xb8a 0xb62 0xbb4 0xbce 0xbe5 0xbf7 0xc0c 0xc1e 0xc30 0xc42 0xc3e 0xc3b 0xc3a 0xc25 0xc13 0xc02 0xbea 0xbdb 0xbc2 0xb9a 0xb84 0xba0 0xbb6 0xbc7 0xbdb 0xbed 0xbfe 0xc11 0xc0c 0xc88 0xc8b 0xc75 0xc63 0xc50 0xc3b 0xc2b 0xc10 0xbe9 0xb95 0xbaf 0xbc7 0xbd9 0xbec 0xbff 0xc11 0xc24 0xc22 0xc63 0xc63 0xc4c 0xc3a 0xc29 0xc14 0xbff 0xbe6 0xbc3 0xb8b 0xba4 0xbbd 0xbd0 0xbe2 0xbf3 0xc05 0xc18 0xc17 0xc83 0xc87 0xc73 0xc60 0xc4f 0xc39 0xc25 0xc08 0xbdc 0xbde 0xbfb 0xc14 0xc26 0xc3b 0xc4e 0xc5e 0xc73 0xc71 0xbbb 0xcaa 0xc94 0xc83 0xc6f 0xc59 0xc44 0xc29 0xc01 0xbee 0xc0d 0xc25 0xc3a 0xc4f 0xc61 0xc73 0xc87 0xb9c 0xb8a 0xc80 0xc6b 0xc59 0xc45 0xc2d 0xc1d 0xbfc 0xbd5 0xbde 0xbfa 0xc11 0xc26 0xc3b 0xc4f 0xc61 0xc75 0xb88 0xb7c 0xc76 0xc63 0xc50 0xc3d 0xc25 0xc14 0xbf5 0xbd0 0xc1b 0xc36 0xc4f 0xc63 0xc79 0xc88 0xc9c 0xcad 0xbbd 0xbd0 0xc6b 0xc99 0xc87 0xc73 0xc5d 0xc47 0xc26 0xc05 0xc08 0xc21 0xc44 0xc5e 0xc7f 0xc98 0xcad 0xc86 0xbed 0x1400 0x1400 0x1400>;
					PS_Config_Lmt_PenRingX_FW_Diff_N = <0xfffffc9a 0xfffffc9a 0xfffffc9a 0xfffffc9a 0xfffffc9a 0xfffffc9a 0xfffffc9a 0xfffffc9a 0xfffffc9a 0xfffffc9a 0xfffffc9a 0xfffffc9a 0xfffffc9a 0xfffffc9a 0xfffffc9a 0xfffffc9a 0xfffffc9a 0xfffffc9a 0xfffffc9a 0xfffffc9a 0xfffffc9a 0xfffffc9a 0xfffffc9a 0xfffffc9a 0xfffffc9a 0xfffffc9a 0xfffffc9a 0xfffffc9a 0xfffffc9a 0xfffffc9a 0xfffffc9a 0xfffffc9a 0xfffffc9a 0xfffffc9a 0xfffffc9a 0xfffffc9a 0xfffffc9a 0xfffffc9a 0xfffffc9a 0xfffffc9a 0xfffffc9a 0xfffffc9a 0xfffffc9a 0xfffffc9a 0xfffffc9a 0xfffffc9a 0xfffffc9a 0xfffffc9a 0xfffffc9a 0xfffffc9a 0xfffffc9a 0xfffffc9a 0xfffffc9a 0xfffffc9a 0xfffffc9a 0xfffffc9a 0xfffffc9a 0xfffffc9a 0xfffffc9a 0xfffffc9a 0xfffffc9a 0xfffffc9a 0xfffffc9a 0xfffffc9a 0xfffffc9a 0xfffffc9a 0xfffffc9a 0xfffffc9a 0xfffffc9a 0xfffffc9a 0xfffffc9a 0xfffffc9a 0xfffffc9a 0xfffffc9a 0xfffffc9a 0xfffffc9a 0xfffffc9a 0xfffffc9a 0xfffffc9a 0xfffffc9a 0xfffffc9a 0xfffffc9a 0xfffffc9a 0xfffffc9a 0xfffffc9a 0xfffffc9a 0xfffffc9a 0xfffffc9a 0xfffffc9a 0xfffffc9a 0xfffffc9a 0xfffffc9a 0xfffffc9a 0xfffffc9a 0xfffffc9a 0xfffffc9a 0xfffffc9a 0xfffffc9a 0xfffffc9a 0xfffffc9a 0xfffffc9a 0xfffffc9a 0xfffffc9a 0xfffffc9a 0xfffffc9a 0xfffffc9a 0xfffffc9a 0xfffffc9a 0xfffffc9a 0xfffffc9a 0xfffffc9a 0xfffffc9a 0xfffffc9a 0xfffffc9a 0xfffffc9a 0xfffffc9a 0xfffffc9a 0xfffffc9a 0xfffffc9a 0xfffffc9a 0xfffffc9a 0xfffffc9a 0xfffffc9a 0xfffffc9a 0xfffffc9a 0xfffffc9a 0xfffffc9a 0xfffffc9a 0xfffffc9a 0xfffffc9a 0xfffffc9a 0xfffffc9a 0xfffffc9a 0xfffffc9a 0xfffffc9a 0xfffffc9a 0xfffffc9a 0xfffffc9a 0xfffffc9a 0xfffffc9a 0xfffffc9a 0xfffffc9a 0xfffffc9a 0xfffffc9a 0xfffffc9a 0xfffffc9a 0xfffffc9a 0xfffffc9a 0xfffffc9a 0xfffffc9a 0xfffffc9a 0xfffffc9a 0xfffffc9a 0xfffffc9a 0xfffffc9a 0xfffffc9a 0xfffffc9a 0xfffffc9a 0xfffffc9a 0xfffffc9a 0xfffffc9a 0xfffffc9a 0xfffffc9a 0xfffffc9a 0xfffffc9a 0xfffffc9a 0xfffffc9a 0xfffffc9a 0xfffffc9a 0xfffffc9a 0xfffffc9a 0xfffffc9a 0xfffffc9a 0xfffffc9a 0xfffffc9a 0xfffffc9a 0xfffffc9a 0xfffffc9a 0xfffffc9a 0xfffffc9a 0xfffffc9a 0xfffffc9a 0xfffffc9a 0xfffffc9a 0xfffffc9a 0xfffffc9a 0xfffffc9a 0xfffffc9a 0xfffffc9a 0xfffffc9a 0xfffffc9a 0xfffffc9a>;
					PS_Config_Lmt_PenRingX_FW_Diff_P = <0x366 0x366 0x366 0x366 0x366 0x366 0x366 0x366 0x366 0x366 0x366 0x366 0x366 0x366 0x366 0x366 0x366 0x366 0x366 0x366 0x366 0x366 0x366 0x366 0x366 0x366 0x366 0x366 0x366 0x366 0x366 0x366 0x366 0x366 0x366 0x366 0x366 0x366 0x366 0x366 0x366 0x366 0x366 0x366 0x366 0x366 0x366 0x366 0x366 0x366 0x366 0x366 0x366 0x366 0x366 0x366 0x366 0x366 0x366 0x366 0x366 0x366 0x366 0x366 0x366 0x366 0x366 0x366 0x366 0x366 0x366 0x366 0x366 0x366 0x366 0x366 0x366 0x366 0x366 0x366 0x366 0x366 0x366 0x366 0x366 0x366 0x366 0x366 0x366 0x366 0x366 0x366 0x366 0x366 0x366 0x366 0x366 0x366 0x366 0x366 0x366 0x366 0x366 0x366 0x366 0x366 0x366 0x366 0x366 0x366 0x366 0x366 0x366 0x366 0x366 0x366 0x366 0x366 0x366 0x366 0x366 0x366 0x366 0x366 0x366 0x366 0x366 0x366 0x366 0x366 0x366 0x366 0x366 0x366 0x366 0x366 0x366 0x366 0x366 0x366 0x366 0x366 0x366 0x366 0x366 0x366 0x366 0x366 0x366 0x366 0x366 0x366 0x366 0x366 0x366 0x366 0x366 0x366 0x366 0x366 0x366 0x366 0x366 0x366 0x366 0x366 0x366 0x366 0x366 0x366 0x366 0x366 0x366 0x366 0x366 0x366 0x366 0x366 0x366 0x366 0x366 0x366 0x366 0x366 0x366 0x366 0x366 0x366 0x366 0x366 0x366 0x366>;
					PS_Config_Lmt_PenRingX_FW_Raw_N = <0xfffffdc6 0xfffffdc6 0xfffffdc6 0xfffffdc6 0xfffffdc6 0xfffffdc6 0xfffffdc6 0xfffffdc6 0xfffffdc6 0xfffffdc6 0xfffffdc6 0xfffffdc6 0xfffffdc6 0xfffffdc6 0xfffffdc6 0xfffffdc6 0xfffffdc6 0xfffffdc6 0xfffffdc6 0xfffffdc6 0xfffffdc6 0xfffffdc6 0xfffffdc6 0xfffffdc6 0xfffffdc6 0xfffffdc6 0xfffffdc6 0xfffffdc6 0xfffffdc6 0xfffffdc6 0xfffffdc6 0xfffffdc6 0xfffffdc6 0xfffffdc6 0xfffffdc6 0xfffffdc6 0xfffffdc6 0xfffffdc6 0xfffffdc6 0xfffffdc6 0xfffffdc6 0xfffffdc6 0xfffffdc6 0xfffffdc6 0xfffffdc6 0xfffffdc6 0xfffffdc6 0xfffffdc6 0xfffffdc6 0xfffffdc6 0xfffffdc6 0xfffffdc6 0xfffffdc6 0xfffffdc6 0xfffffdc6 0xfffffdc6 0xfffffdc6 0xfffffdc6 0xfffffdc6 0xfffffdc6 0xfffffdc6 0xfffffdc6 0xfffffdc6 0xfffffdc6 0xfffffdc6 0xfffffdc6 0xfffffdc6 0xfffffdc6 0xfffffdc6 0xfffffdc6 0xfffffdc6 0xfffffdc6 0xfffffdc6 0xfffffdc6 0xfffffdc6 0xfffffdc6 0xfffffdc6 0xfffffdc6 0xfffffdc6 0xfffffdc6 0xfffffdc6 0xfffffdc6 0xfffffdc6 0xfffffdc6 0xfffffdc6 0xfffffdc6 0xfffffdc6 0xfffffdc6 0xfffffdc6 0xfffffdc6 0xfffffdc6 0xfffffdc6 0xfffffdc6 0xfffffdc6 0xfffffdc6 0xfffffdc6 0xfffffdc6 0xfffffdc6 0xfffffdc6 0xfffffdc6 0xfffffdc6 0xfffffdc6 0xfffffdc6 0xfffffdc6 0xfffffdc6 0xfffffdc6 0xfffffdc6 0xfffffdc6 0xfffffdc6 0xfffffdc6 0xfffffdc6 0xfffffdc6 0xfffffdc6 0xfffffdc6 0xfffffdc6 0xfffffdc6 0xfffffdc6 0xfffffdc6 0xfffffdc6 0xfffffdc6 0xfffffdc6 0xfffffdc6 0xfffffdc6 0xfffffdc6 0xfffffdc6 0xfffffdc6 0xfffffdc6 0xfffffdc6 0xfffffdc6 0xfffffdc6 0xfffffdc6 0xfffffdc6 0xfffffdc6 0xfffffdc6 0xfffffdc6 0xfffffdc6 0xfffffdc6 0xfffffdc6 0xfffffdc6 0xfffffdc6 0xfffffdc6 0xfffffdc6 0xfffffdc6 0xfffffdc6 0xfffffdc6 0xfffffdc6 0xfffffdc6 0xfffffdc6 0xfffffdc6 0xfffffdc6 0xfffffdc6 0xfffffdc6 0xfffffdc6 0xfffffdc6 0xfffffdc6 0xfffffdc6 0xfffffdc6 0xfffffdc6 0xfffffdc6 0xfffffdc6 0xfffffdc6 0xfffffdc6 0xfffffdc6 0xfffffdc6 0xfffffdc6 0xfffffdc6 0xfffffdc6 0xfffffdc6 0xfffffdc6 0xfffffdc6 0xfffffdc6 0xfffffdc6 0xfffffdc6 0xfffffdc6 0xfffffdc6 0xfffffdc6 0xfffffdc6 0xfffffdc6 0xfffffdc6 0xfffffdc6 0xfffffdc6 0xfffffdc6 0xfffffdc6 0xfffffdc6 0xfffffdc6 0xfffffdc6 0xfffffdc6 0xfffffdc6 0xfffffdc6 0xfffffdc6 0xfffffdc6 0xfffffdc6>;
					PS_Config_Lmt_PenRingX_FW_Raw_P = <0x23a 0x23a 0x23a 0x23a 0x23a 0x23a 0x23a 0x23a 0x23a 0x23a 0x23a 0x23a 0x23a 0x23a 0x23a 0x23a 0x23a 0x23a 0x23a 0x23a 0x23a 0x23a 0x23a 0x23a 0x23a 0x23a 0x23a 0x23a 0x23a 0x23a 0x23a 0x23a 0x23a 0x23a 0x23a 0x23a 0x23a 0x23a 0x23a 0x23a 0x23a 0x23a 0x23a 0x23a 0x23a 0x23a 0x23a 0x23a 0x23a 0x23a 0x23a 0x23a 0x23a 0x23a 0x23a 0x23a 0x23a 0x23a 0x23a 0x23a 0x23a 0x23a 0x23a 0x23a 0x23a 0x23a 0x23a 0x23a 0x23a 0x23a 0x23a 0x23a 0x23a 0x23a 0x23a 0x23a 0x23a 0x23a 0x23a 0x23a 0x23a 0x23a 0x23a 0x23a 0x23a 0x23a 0x23a 0x23a 0x23a 0x23a 0x23a 0x23a 0x23a 0x23a 0x23a 0x23a 0x23a 0x23a 0x23a 0x23a 0x23a 0x23a 0x23a 0x23a 0x23a 0x23a 0x23a 0x23a 0x23a 0x23a 0x23a 0x23a 0x23a 0x23a 0x23a 0x23a 0x23a 0x23a 0x23a 0x23a 0x23a 0x23a 0x23a 0x23a 0x23a 0x23a 0x23a 0x23a 0x23a 0x23a 0x23a 0x23a 0x23a 0x23a 0x23a 0x23a 0x23a 0x23a 0x23a 0x23a 0x23a 0x23a 0x23a 0x23a 0x23a 0x23a 0x23a 0x23a 0x23a 0x23a 0x23a 0x23a 0x23a 0x23a 0x23a 0x23a 0x23a 0x23a 0x23a 0x23a 0x23a 0x23a 0x23a 0x23a 0x23a 0x23a 0x23a 0x23a 0x23a 0x23a 0x23a 0x23a 0x23a 0x23a 0x23a 0x23a 0x23a 0x23a 0x23a 0x23a 0x23a 0x23a 0x23a 0x23a 0x23a 0x23a 0x23a 0x23a 0x23a 0x23a 0x23a 0x23a>;
					PS_Config_Lmt_PenRingY_FW_Diff_N = <0xfffffc9a 0xfffffc9a 0xfffffc9a 0xfffffc9a 0xfffffc9a 0xfffffc9a 0xfffffc9a 0xfffffc9a 0xfffffc9a 0xfffffc9a 0xfffffc9a 0xfffffc9a 0xfffffc9a 0xfffffc9a 0xfffffc9a 0xfffffc9a 0xfffffc9a 0xfffffc9a 0xfffffc9a 0xfffffc9a 0xfffffc9a 0xfffffc9a 0xfffffc9a 0xfffffc9a 0xfffffc9a 0xfffffc9a 0xfffffc9a 0xfffffc9a 0xfffffc9a 0xfffffc9a 0xfffffc9a 0xfffffc9a 0xfffffc9a 0xfffffc9a 0xfffffc9a 0xfffffc9a 0xfffffc9a 0xfffffc9a 0xfffffc9a 0xfffffc9a 0xfffffc9a 0xfffffc9a 0xfffffc9a 0xfffffc9a 0xfffffc9a 0xfffffc9a 0xfffffc9a 0xfffffc9a 0xfffffc9a 0xfffffc9a 0xfffffc9a 0xfffffc9a 0xfffffc9a 0xfffffc9a 0xfffffc9a 0xfffffc9a 0xfffffc9a 0xfffffc9a 0xfffffc9a 0xfffffc9a 0xfffffc9a 0xfffffc9a 0xfffffc9a 0xfffffc9a 0xfffffc9a 0xfffffc9a 0xfffffc9a 0xfffffc9a 0xfffffc9a 0xfffffc9a 0xfffffc9a 0xfffffc9a 0xfffffc9a 0xfffffc9a 0xfffffc9a 0xfffffc9a 0xfffffc9a 0xfffffc9a 0xfffffc9a 0xfffffc9a 0xfffffc9a 0xfffffc9a 0xfffffc9a 0xfffffc9a 0xfffffc9a 0xfffffc9a 0xfffffc9a 0xfffffc9a 0xfffffc9a 0xfffffc9a 0xfffffc9a 0xfffffc9a 0xfffffc9a 0xfffffc9a 0xfffffc9a 0xfffffc9a 0xfffffc9a 0xfffffc9a 0xfffffc9a 0xfffffc9a 0xfffffc9a 0xfffffc9a 0xfffffc9a 0xfffffc9a 0xfffffc9a 0xfffffc9a 0xfffffc9a 0xfffffc9a 0xfffffc9a 0xfffffc9a 0xfffffc9a 0xfffffc9a 0xfffffc9a 0xfffffc9a 0xfffffc9a 0xfffffc9a 0xfffffc9a 0xfffffc9a 0xfffffc9a 0xfffffc9a 0xfffffc9a 0xfffffc9a 0xfffffc9a 0xfffffc9a 0xfffffc9a 0xfffffc9a 0xfffffc9a 0xfffffc9a 0xfffffc9a 0xfffffc9a 0xfffffc9a 0xfffffc9a 0xfffffc9a 0xfffffc9a 0xfffffc9a 0xfffffc9a 0xfffffc9a 0xfffffc9a 0xfffffc9a 0xfffffc9a 0xfffffc9a 0xfffffc9a 0xfffffc9a 0xfffffc9a 0xfffffc9a 0xfffffc9a 0xfffffc9a 0xfffffc9a 0xfffffc9a 0xfffffc9a 0xfffffc9a 0xfffffc9a 0xfffffc9a 0xfffffc9a 0xfffffc9a 0xfffffc9a 0xfffffc9a 0xfffffc9a 0xfffffc9a 0xfffffc9a 0xfffffc9a 0xfffffc9a 0xfffffc9a 0xfffffc9a 0xfffffc9a 0xfffffc9a 0xfffffc9a 0xfffffc9a 0xfffffc9a 0xfffffc9a 0xfffffc9a 0xfffffc9a 0xfffffc9a 0xfffffc9a 0xfffffc9a 0xfffffc9a 0xfffffc9a 0xfffffc9a 0xfffffc9a 0xfffffc9a 0xfffffc9a 0xfffffc9a 0xfffffc9a 0xfffffc9a 0xfffffc9a 0xfffffc9a 0xfffffc9a 0xfffffc9a 0xfffffc9a 0xfffffc9a 0xfffffc9a 0xfffffc9a 0xfffffc9a 0xfffffc9a 0xfffffc9a 0xfffffc9a 0xfffffc9a 0xfffffc9a 0xfffffc9a 0xfffffc9a>;
					PS_Config_Lmt_PenRingY_FW_Diff_P = <0x366 0x366 0x366 0x366 0x366 0x366 0x366 0x366 0x366 0x366 0x366 0x366 0x366 0x366 0x366 0x366 0x366 0x366 0x366 0x366 0x366 0x366 0x366 0x366 0x366 0x366 0x366 0x366 0x366 0x366 0x366 0x366 0x366 0x366 0x366 0x366 0x366 0x366 0x366 0x366 0x366 0x366 0x366 0x366 0x366 0x366 0x366 0x366 0x366 0x366 0x366 0x366 0x366 0x366 0x366 0x366 0x366 0x366 0x366 0x366 0x366 0x366 0x366 0x366 0x366 0x366 0x366 0x366 0x366 0x366 0x366 0x366 0x366 0x366 0x366 0x366 0x366 0x366 0x366 0x366 0x366 0x366 0x366 0x366 0x366 0x366 0x366 0x366 0x366 0x366 0x366 0x366 0x366 0x366 0x366 0x366 0x366 0x366 0x366 0x366 0x366 0x366 0x366 0x366 0x366 0x366 0x366 0x366 0x366 0x366 0x366 0x366 0x366 0x366 0x366 0x366 0x366 0x366 0x366 0x366 0x366 0x366 0x366 0x366 0x366 0x366 0x366 0x366 0x366 0x366 0x366 0x366 0x366 0x366 0x366 0x366 0x366 0x366 0x366 0x366 0x366 0x366 0x366 0x366 0x366 0x366 0x366 0x366 0x366 0x366 0x366 0x366 0x366 0x366 0x366 0x366 0x366 0x366 0x366 0x366 0x366 0x366 0x366 0x366 0x366 0x366 0x366 0x366 0x366 0x366 0x366 0x366 0x366 0x366 0x366 0x366 0x366 0x366 0x366 0x366 0x366 0x366 0x366 0x366 0x366 0x366 0x366 0x366 0x366 0x366 0x366 0x366 0x366 0x366 0x366 0x366 0x366 0x366 0x366 0x366>;
					PS_Config_Lmt_PenRingY_FW_Raw_N = <0xfffffdc6 0xfffffdc6 0xfffffdc6 0xfffffdc6 0xfffffdc6 0xfffffdc6 0xfffffdc6 0xfffffdc6 0xfffffdc6 0xfffffdc6 0xfffffdc6 0xfffffdc6 0xfffffdc6 0xfffffdc6 0xfffffdc6 0xfffffdc6 0xfffffdc6 0xfffffdc6 0xfffffdc6 0xfffffdc6 0xfffffdc6 0xfffffdc6 0xfffffdc6 0xfffffdc6 0xfffffdc6 0xfffffdc6 0xfffffdc6 0xfffffdc6 0xfffffdc6 0xfffffdc6 0xfffffdc6 0xfffffdc6 0xfffffdc6 0xfffffdc6 0xfffffdc6 0xfffffdc6 0xfffffdc6 0xfffffdc6 0xfffffdc6 0xfffffdc6 0xfffffdc6 0xfffffdc6 0xfffffdc6 0xfffffdc6 0xfffffdc6 0xfffffdc6 0xfffffdc6 0xfffffdc6 0xfffffdc6 0xfffffdc6 0xfffffdc6 0xfffffdc6 0xfffffdc6 0xfffffdc6 0xfffffdc6 0xfffffdc6 0xfffffdc6 0xfffffdc6 0xfffffdc6 0xfffffdc6 0xfffffdc6 0xfffffdc6 0xfffffdc6 0xfffffdc6 0xfffffdc6 0xfffffdc6 0xfffffdc6 0xfffffdc6 0xfffffdc6 0xfffffdc6 0xfffffdc6 0xfffffdc6 0xfffffdc6 0xfffffdc6 0xfffffdc6 0xfffffdc6 0xfffffdc6 0xfffffdc6 0xfffffdc6 0xfffffdc6 0xfffffdc6 0xfffffdc6 0xfffffdc6 0xfffffdc6 0xfffffdc6 0xfffffdc6 0xfffffdc6 0xfffffdc6 0xfffffdc6 0xfffffdc6 0xfffffdc6 0xfffffdc6 0xfffffdc6 0xfffffdc6 0xfffffdc6 0xfffffdc6 0xfffffdc6 0xfffffdc6 0xfffffdc6 0xfffffdc6 0xfffffdc6 0xfffffdc6 0xfffffdc6 0xfffffdc6 0xfffffdc6 0xfffffdc6 0xfffffdc6 0xfffffdc6 0xfffffdc6 0xfffffdc6 0xfffffdc6 0xfffffdc6 0xfffffdc6 0xfffffdc6 0xfffffdc6 0xfffffdc6 0xfffffdc6 0xfffffdc6 0xfffffdc6 0xfffffdc6 0xfffffdc6 0xfffffdc6 0xfffffdc6 0xfffffdc6 0xfffffdc6 0xfffffdc6 0xfffffdc6 0xfffffdc6 0xfffffdc6 0xfffffdc6 0xfffffdc6 0xfffffdc6 0xfffffdc6 0xfffffdc6 0xfffffdc6 0xfffffdc6 0xfffffdc6 0xfffffdc6 0xfffffdc6 0xfffffdc6 0xfffffdc6 0xfffffdc6 0xfffffdc6 0xfffffdc6 0xfffffdc6 0xfffffdc6 0xfffffdc6 0xfffffdc6 0xfffffdc6 0xfffffdc6 0xfffffdc6 0xfffffdc6 0xfffffdc6 0xfffffdc6 0xfffffdc6 0xfffffdc6 0xfffffdc6 0xfffffdc6 0xfffffdc6 0xfffffdc6 0xfffffdc6 0xfffffdc6 0xfffffdc6 0xfffffdc6 0xfffffdc6 0xfffffdc6 0xfffffdc6 0xfffffdc6 0xfffffdc6 0xfffffdc6 0xfffffdc6 0xfffffdc6 0xfffffdc6 0xfffffdc6 0xfffffdc6 0xfffffdc6 0xfffffdc6 0xfffffdc6 0xfffffdc6 0xfffffdc6 0xfffffdc6 0xfffffdc6 0xfffffdc6 0xfffffdc6 0xfffffdc6 0xfffffdc6 0xfffffdc6 0xfffffdc6 0xfffffdc6 0xfffffdc6 0xfffffdc6 0xfffffdc6 0xfffffdc6 0xfffffdc6 0xfffffdc6 0xfffffdc6 0xfffffdc6 0xfffffdc6 0xfffffdc6 0xfffffdc6>;
					PS_Config_Lmt_PenRingY_FW_Raw_P = <0x23a 0x23a 0x23a 0x23a 0x23a 0x23a 0x23a 0x23a 0x23a 0x23a 0x23a 0x23a 0x23a 0x23a 0x23a 0x23a 0x23a 0x23a 0x23a 0x23a 0x23a 0x23a 0x23a 0x23a 0x23a 0x23a 0x23a 0x23a 0x23a 0x23a 0x23a 0x23a 0x23a 0x23a 0x23a 0x23a 0x23a 0x23a 0x23a 0x23a 0x23a 0x23a 0x23a 0x23a 0x23a 0x23a 0x23a 0x23a 0x23a 0x23a 0x23a 0x23a 0x23a 0x23a 0x23a 0x23a 0x23a 0x23a 0x23a 0x23a 0x23a 0x23a 0x23a 0x23a 0x23a 0x23a 0x23a 0x23a 0x23a 0x23a 0x23a 0x23a 0x23a 0x23a 0x23a 0x23a 0x23a 0x23a 0x23a 0x23a 0x23a 0x23a 0x23a 0x23a 0x23a 0x23a 0x23a 0x23a 0x23a 0x23a 0x23a 0x23a 0x23a 0x23a 0x23a 0x23a 0x23a 0x23a 0x23a 0x23a 0x23a 0x23a 0x23a 0x23a 0x23a 0x23a 0x23a 0x23a 0x23a 0x23a 0x23a 0x23a 0x23a 0x23a 0x23a 0x23a 0x23a 0x23a 0x23a 0x23a 0x23a 0x23a 0x23a 0x23a 0x23a 0x23a 0x23a 0x23a 0x23a 0x23a 0x23a 0x23a 0x23a 0x23a 0x23a 0x23a 0x23a 0x23a 0x23a 0x23a 0x23a 0x23a 0x23a 0x23a 0x23a 0x23a 0x23a 0x23a 0x23a 0x23a 0x23a 0x23a 0x23a 0x23a 0x23a 0x23a 0x23a 0x23a 0x23a 0x23a 0x23a 0x23a 0x23a 0x23a 0x23a 0x23a 0x23a 0x23a 0x23a 0x23a 0x23a 0x23a 0x23a 0x23a 0x23a 0x23a 0x23a 0x23a 0x23a 0x23a 0x23a 0x23a 0x23a 0x23a 0x23a 0x23a 0x23a 0x23a 0x23a 0x23a 0x23a 0x23a 0x23a 0x23a 0x23a 0x23a 0x23a 0x23a 0x23a 0x23a>;
					PS_Config_Lmt_PenTipX_FW_Diff_N = <0xfffffc9a 0xfffffc9a 0xfffffc9a 0xfffffc9a 0xfffffc9a 0xfffffc9a 0xfffffc9a 0xfffffc9a 0xfffffc9a 0xfffffc9a 0xfffffc9a 0xfffffc9a 0xfffffc9a 0xfffffc9a 0xfffffc9a 0xfffffc9a 0xfffffc9a 0xfffffc9a 0xfffffc9a 0xfffffc9a 0xfffffc9a 0xfffffc9a 0xfffffc9a 0xfffffc9a 0xfffffc9a 0xfffffc9a 0xfffffc9a 0xfffffc9a 0xfffffc9a 0xfffffc9a 0xfffffc9a 0xfffffc9a 0xfffffc9a 0xfffffc9a 0xfffffc9a 0xfffffc9a 0xfffffc9a 0xfffffc9a 0xfffffc9a 0xfffffc9a 0xfffffc9a 0xfffffc9a 0xfffffc9a 0xfffffc9a 0xfffffc9a 0xfffffc9a 0xfffffc9a 0xfffffc9a 0xfffffc9a 0xfffffc9a 0xfffffc9a 0xfffffc9a 0xfffffc9a 0xfffffc9a 0xfffffc9a 0xfffffc9a 0xfffffc9a 0xfffffc9a 0xfffffc9a 0xfffffc9a 0xfffffc9a 0xfffffc9a 0xfffffc9a 0xfffffc9a 0xfffffc9a 0xfffffc9a 0xfffffc9a 0xfffffc9a 0xfffffc9a 0xfffffc9a 0xfffffc9a 0xfffffc9a 0xfffffc9a 0xfffffc9a 0xfffffc9a 0xfffffc9a 0xfffffc9a 0xfffffc9a 0xfffffc9a 0xfffffc9a 0xfffffc9a 0xfffffc9a 0xfffffc9a 0xfffffc9a 0xfffffc9a 0xfffffc9a 0xfffffc9a 0xfffffc9a 0xfffffc9a 0xfffffc9a 0xfffffc9a 0xfffffc9a 0xfffffc9a 0xfffffc9a 0xfffffc9a 0xfffffc9a 0xfffffc9a 0xfffffc9a 0xfffffc9a 0xfffffc9a 0xfffffc9a 0xfffffc9a 0xfffffc9a 0xfffffc9a 0xfffffc9a 0xfffffc9a 0xfffffc9a 0xfffffc9a 0xfffffc9a 0xfffffc9a 0xfffffc9a 0xfffffc9a 0xfffffc9a 0xfffffc9a 0xfffffc9a 0xfffffc9a 0xfffffc9a 0xfffffc9a 0xfffffc9a 0xfffffc9a 0xfffffc9a 0xfffffc9a 0xfffffc9a 0xfffffc9a 0xfffffc9a 0xfffffc9a 0xfffffc9a 0xfffffc9a 0xfffffc9a 0xfffffc9a 0xfffffc9a 0xfffffc9a 0xfffffc9a 0xfffffc9a 0xfffffc9a 0xfffffc9a 0xfffffc9a 0xfffffc9a 0xfffffc9a 0xfffffc9a 0xfffffc9a 0xfffffc9a 0xfffffc9a 0xfffffc9a 0xfffffc9a 0xfffffc9a 0xfffffc9a 0xfffffc9a 0xfffffc9a 0xfffffc9a 0xfffffc9a 0xfffffc9a 0xfffffc9a 0xfffffc9a 0xfffffc9a 0xfffffc9a 0xfffffc9a 0xfffffc9a 0xfffffc9a 0xfffffc9a 0xfffffc9a 0xfffffc9a 0xfffffc9a 0xfffffc9a 0xfffffc9a 0xfffffc9a 0xfffffc9a 0xfffffc9a 0xfffffc9a 0xfffffc9a 0xfffffc9a 0xfffffc9a 0xfffffc9a 0xfffffc9a 0xfffffc9a 0xfffffc9a 0xfffffc9a 0xfffffc9a 0xfffffc9a 0xfffffc9a 0xfffffc9a 0xfffffc9a 0xfffffc9a 0xfffffc9a 0xfffffc9a 0xfffffc9a 0xfffffc9a 0xfffffc9a 0xfffffc9a 0xfffffc9a 0xfffffc9a 0xfffffc9a>;
					PS_Config_Lmt_PenTipX_FW_Diff_P = <0x366 0x366 0x366 0x366 0x366 0x366 0x366 0x366 0x366 0x366 0x366 0x366 0x366 0x366 0x366 0x366 0x366 0x366 0x366 0x366 0x366 0x366 0x366 0x366 0x366 0x366 0x366 0x366 0x366 0x366 0x366 0x366 0x366 0x366 0x366 0x366 0x366 0x366 0x366 0x366 0x366 0x366 0x366 0x366 0x366 0x366 0x366 0x366 0x366 0x366 0x366 0x366 0x366 0x366 0x366 0x366 0x366 0x366 0x366 0x366 0x366 0x366 0x366 0x366 0x366 0x366 0x366 0x366 0x366 0x366 0x366 0x366 0x366 0x366 0x366 0x366 0x366 0x366 0x366 0x366 0x366 0x366 0x366 0x366 0x366 0x366 0x366 0x366 0x366 0x366 0x366 0x366 0x366 0x366 0x366 0x366 0x366 0x366 0x366 0x366 0x366 0x366 0x366 0x366 0x366 0x366 0x366 0x366 0x366 0x366 0x366 0x366 0x366 0x366 0x366 0x366 0x366 0x366 0x366 0x366 0x366 0x366 0x366 0x366 0x366 0x366 0x366 0x366 0x366 0x366 0x366 0x366 0x366 0x366 0x366 0x366 0x366 0x366 0x366 0x366 0x366 0x366 0x366 0x366 0x366 0x366 0x366 0x366 0x366 0x366 0x366 0x366 0x366 0x366 0x366 0x366 0x366 0x366 0x366 0x366 0x366 0x366 0x366 0x366 0x366 0x366 0x366 0x366 0x366 0x366 0x366 0x366 0x366 0x366 0x366 0x366 0x366 0x366 0x366 0x366 0x366 0x366 0x366 0x366 0x366 0x366 0x366 0x366 0x366 0x366 0x366 0x366>;
					PS_Config_Lmt_PenTipX_FW_Raw_N = <0xfffffdc6 0xfffffdc6 0xfffffdc6 0xfffffdc6 0xfffffdc6 0xfffffdc6 0xfffffdc6 0xfffffdc6 0xfffffdc6 0xfffffdc6 0xfffffdc6 0xfffffdc6 0xfffffdc6 0xfffffdc6 0xfffffdc6 0xfffffdc6 0xfffffdc6 0xfffffdc6 0xfffffdc6 0xfffffdc6 0xfffffdc6 0xfffffdc6 0xfffffdc6 0xfffffdc6 0xfffffdc6 0xfffffdc6 0xfffffdc6 0xfffffdc6 0xfffffdc6 0xfffffdc6 0xfffffdc6 0xfffffdc6 0xfffffdc6 0xfffffdc6 0xfffffdc6 0xfffffdc6 0xfffffdc6 0xfffffdc6 0xfffffdc6 0xfffffdc6 0xfffffdc6 0xfffffdc6 0xfffffdc6 0xfffffdc6 0xfffffdc6 0xfffffdc6 0xfffffdc6 0xfffffdc6 0xfffffdc6 0xfffffdc6 0xfffffdc6 0xfffffdc6 0xfffffdc6 0xfffffdc6 0xfffffdc6 0xfffffdc6 0xfffffdc6 0xfffffdc6 0xfffffdc6 0xfffffdc6 0xfffffdc6 0xfffffdc6 0xfffffdc6 0xfffffdc6 0xfffffdc6 0xfffffdc6 0xfffffdc6 0xfffffdc6 0xfffffdc6 0xfffffdc6 0xfffffdc6 0xfffffdc6 0xfffffdc6 0xfffffdc6 0xfffffdc6 0xfffffdc6 0xfffffdc6 0xfffffdc6 0xfffffdc6 0xfffffdc6 0xfffffdc6 0xfffffdc6 0xfffffdc6 0xfffffdc6 0xfffffdc6 0xfffffdc6 0xfffffdc6 0xfffffdc6 0xfffffdc6 0xfffffdc6 0xfffffdc6 0xfffffdc6 0xfffffdc6 0xfffffdc6 0xfffffdc6 0xfffffdc6 0xfffffdc6 0xfffffdc6 0xfffffdc6 0xfffffdc6 0xfffffdc6 0xfffffdc6 0xfffffdc6 0xfffffdc6 0xfffffdc6 0xfffffdc6 0xfffffdc6 0xfffffdc6 0xfffffdc6 0xfffffdc6 0xfffffdc6 0xfffffdc6 0xfffffdc6 0xfffffdc6 0xfffffdc6 0xfffffdc6 0xfffffdc6 0xfffffdc6 0xfffffdc6 0xfffffdc6 0xfffffdc6 0xfffffdc6 0xfffffdc6 0xfffffdc6 0xfffffdc6 0xfffffdc6 0xfffffdc6 0xfffffdc6 0xfffffdc6 0xfffffdc6 0xfffffdc6 0xfffffdc6 0xfffffdc6 0xfffffdc6 0xfffffdc6 0xfffffdc6 0xfffffdc6 0xfffffdc6 0xfffffdc6 0xfffffdc6 0xfffffdc6 0xfffffdc6 0xfffffdc6 0xfffffdc6 0xfffffdc6 0xfffffdc6 0xfffffdc6 0xfffffdc6 0xfffffdc6 0xfffffdc6 0xfffffdc6 0xfffffdc6 0xfffffdc6 0xfffffdc6 0xfffffdc6 0xfffffdc6 0xfffffdc6 0xfffffdc6 0xfffffdc6 0xfffffdc6 0xfffffdc6 0xfffffdc6 0xfffffdc6 0xfffffdc6 0xfffffdc6 0xfffffdc6 0xfffffdc6 0xfffffdc6 0xfffffdc6 0xfffffdc6 0xfffffdc6 0xfffffdc6 0xfffffdc6 0xfffffdc6 0xfffffdc6 0xfffffdc6 0xfffffdc6 0xfffffdc6 0xfffffdc6 0xfffffdc6 0xfffffdc6 0xfffffdc6 0xfffffdc6 0xfffffdc6 0xfffffdc6 0xfffffdc6 0xfffffdc6 0xfffffdc6 0xfffffdc6 0xfffffdc6 0xfffffdc6 0xfffffdc6>;
					PS_Config_Lmt_PenTipX_FW_Raw_P = <0x23a 0x23a 0x23a 0x23a 0x23a 0x23a 0x23a 0x23a 0x23a 0x23a 0x23a 0x23a 0x23a 0x23a 0x23a 0x23a 0x23a 0x23a 0x23a 0x23a 0x23a 0x23a 0x23a 0x23a 0x23a 0x23a 0x23a 0x23a 0x23a 0x23a 0x23a 0x23a 0x23a 0x23a 0x23a 0x23a 0x23a 0x23a 0x23a 0x23a 0x23a 0x23a 0x23a 0x23a 0x23a 0x23a 0x23a 0x23a 0x23a 0x23a 0x23a 0x23a 0x23a 0x23a 0x23a 0x23a 0x23a 0x23a 0x23a 0x23a 0x23a 0x23a 0x23a 0x23a 0x23a 0x23a 0x23a 0x23a 0x23a 0x23a 0x23a 0x23a 0x23a 0x23a 0x23a 0x23a 0x23a 0x23a 0x23a 0x23a 0x23a 0x23a 0x23a 0x23a 0x23a 0x23a 0x23a 0x23a 0x23a 0x23a 0x23a 0x23a 0x23a 0x23a 0x23a 0x23a 0x23a 0x23a 0x23a 0x23a 0x23a 0x23a 0x23a 0x23a 0x23a 0x23a 0x23a 0x23a 0x23a 0x23a 0x23a 0x23a 0x23a 0x23a 0x23a 0x23a 0x23a 0x23a 0x23a 0x23a 0x23a 0x23a 0x23a 0x23a 0x23a 0x23a 0x23a 0x23a 0x23a 0x23a 0x23a 0x23a 0x23a 0x23a 0x23a 0x23a 0x23a 0x23a 0x23a 0x23a 0x23a 0x23a 0x23a 0x23a 0x23a 0x23a 0x23a 0x23a 0x23a 0x23a 0x23a 0x23a 0x23a 0x23a 0x23a 0x23a 0x23a 0x23a 0x23a 0x23a 0x23a 0x23a 0x23a 0x23a 0x23a 0x23a 0x23a 0x23a 0x23a 0x23a 0x23a 0x23a 0x23a 0x23a 0x23a 0x23a 0x23a 0x23a 0x23a 0x23a 0x23a 0x23a 0x23a 0x23a 0x23a 0x23a 0x23a 0x23a 0x23a 0x23a 0x23a 0x23a>;
					PS_Config_Lmt_PenTipY_FW_Diff_N = <0xfffffc9a 0xfffffc9a 0xfffffc9a 0xfffffc9a 0xfffffc9a 0xfffffc9a 0xfffffc9a 0xfffffc9a 0xfffffc9a 0xfffffc9a 0xfffffc9a 0xfffffc9a 0xfffffc9a 0xfffffc9a 0xfffffc9a 0xfffffc9a 0xfffffc9a 0xfffffc9a 0xfffffc9a 0xfffffc9a 0xfffffc9a 0xfffffc9a 0xfffffc9a 0xfffffc9a 0xfffffc9a 0xfffffc9a 0xfffffc9a 0xfffffc9a 0xfffffc9a 0xfffffc9a 0xfffffc9a 0xfffffc9a 0xfffffc9a 0xfffffc9a 0xfffffc9a 0xfffffc9a 0xfffffc9a 0xfffffc9a 0xfffffc9a 0xfffffc9a 0xfffffc9a 0xfffffc9a 0xfffffc9a 0xfffffc9a 0xfffffc9a 0xfffffc9a 0xfffffc9a 0xfffffc9a 0xfffffc9a 0xfffffc9a 0xfffffc9a 0xfffffc9a 0xfffffc9a 0xfffffc9a 0xfffffc9a 0xfffffc9a 0xfffffc9a 0xfffffc9a 0xfffffc9a 0xfffffc9a 0xfffffc9a 0xfffffc9a 0xfffffc9a 0xfffffc9a 0xfffffc9a 0xfffffc9a 0xfffffc9a 0xfffffc9a 0xfffffc9a 0xfffffc9a 0xfffffc9a 0xfffffc9a 0xfffffc9a 0xfffffc9a 0xfffffc9a 0xfffffc9a 0xfffffc9a 0xfffffc9a 0xfffffc9a 0xfffffc9a 0xfffffc9a 0xfffffc9a 0xfffffc9a 0xfffffc9a 0xfffffc9a 0xfffffc9a 0xfffffc9a 0xfffffc9a 0xfffffc9a 0xfffffc9a 0xfffffc9a 0xfffffc9a 0xfffffc9a 0xfffffc9a 0xfffffc9a 0xfffffc9a 0xfffffc9a 0xfffffc9a 0xfffffc9a 0xfffffc9a 0xfffffc9a 0xfffffc9a 0xfffffc9a 0xfffffc9a 0xfffffc9a 0xfffffc9a 0xfffffc9a 0xfffffc9a 0xfffffc9a 0xfffffc9a 0xfffffc9a 0xfffffc9a 0xfffffc9a 0xfffffc9a 0xfffffc9a 0xfffffc9a 0xfffffc9a 0xfffffc9a 0xfffffc9a 0xfffffc9a 0xfffffc9a 0xfffffc9a 0xfffffc9a 0xfffffc9a 0xfffffc9a 0xfffffc9a 0xfffffc9a 0xfffffc9a 0xfffffc9a 0xfffffc9a 0xfffffc9a 0xfffffc9a 0xfffffc9a 0xfffffc9a 0xfffffc9a 0xfffffc9a 0xfffffc9a 0xfffffc9a 0xfffffc9a 0xfffffc9a 0xfffffc9a 0xfffffc9a 0xfffffc9a 0xfffffc9a 0xfffffc9a 0xfffffc9a 0xfffffc9a 0xfffffc9a 0xfffffc9a 0xfffffc9a 0xfffffc9a 0xfffffc9a 0xfffffc9a 0xfffffc9a 0xfffffc9a 0xfffffc9a 0xfffffc9a 0xfffffc9a 0xfffffc9a 0xfffffc9a 0xfffffc9a 0xfffffc9a 0xfffffc9a 0xfffffc9a 0xfffffc9a 0xfffffc9a 0xfffffc9a 0xfffffc9a 0xfffffc9a 0xfffffc9a 0xfffffc9a 0xfffffc9a 0xfffffc9a 0xfffffc9a 0xfffffc9a 0xfffffc9a 0xfffffc9a 0xfffffc9a 0xfffffc9a 0xfffffc9a 0xfffffc9a 0xfffffc9a 0xfffffc9a 0xfffffc9a 0xfffffc9a 0xfffffc9a 0xfffffc9a 0xfffffc9a 0xfffffc9a 0xfffffc9a 0xfffffc9a 0xfffffc9a 0xfffffc9a 0xfffffc9a 0xfffffc9a 0xfffffc9a 0xfffffc9a 0xfffffc9a 0xfffffc9a 0xfffffc9a>;
					PS_Config_Lmt_PenTipY_FW_Diff_P = <0x366 0x366 0x366 0x366 0x366 0x366 0x366 0x366 0x366 0x366 0x366 0x366 0x366 0x366 0x366 0x366 0x366 0x366 0x366 0x366 0x366 0x366 0x366 0x366 0x366 0x366 0x366 0x366 0x366 0x366 0x366 0x366 0x366 0x366 0x366 0x366 0x366 0x366 0x366 0x366 0x366 0x366 0x366 0x366 0x366 0x366 0x366 0x366 0x366 0x366 0x366 0x366 0x366 0x366 0x366 0x366 0x366 0x366 0x366 0x366 0x366 0x366 0x366 0x366 0x366 0x366 0x366 0x366 0x366 0x366 0x366 0x366 0x366 0x366 0x366 0x366 0x366 0x366 0x366 0x366 0x366 0x366 0x366 0x366 0x366 0x366 0x366 0x366 0x366 0x366 0x366 0x366 0x366 0x366 0x366 0x366 0x366 0x366 0x366 0x366 0x366 0x366 0x366 0x366 0x366 0x366 0x366 0x366 0x366 0x366 0x366 0x366 0x366 0x366 0x366 0x366 0x366 0x366 0x366 0x366 0x366 0x366 0x366 0x366 0x366 0x366 0x366 0x366 0x366 0x366 0x366 0x366 0x366 0x366 0x366 0x366 0x366 0x366 0x366 0x366 0x366 0x366 0x366 0x366 0x366 0x366 0x366 0x366 0x366 0x366 0x366 0x366 0x366 0x366 0x366 0x366 0x366 0x366 0x366 0x366 0x366 0x366 0x366 0x366 0x366 0x366 0x366 0x366 0x366 0x366 0x366 0x366 0x366 0x366 0x366 0x366 0x366 0x366 0x366 0x366 0x366 0x366 0x366 0x366 0x366 0x366 0x366 0x366 0x366 0x366 0x366 0x366 0x366 0x366 0x366 0x366 0x366 0x366 0x366 0x366>;
					PS_Config_Lmt_PenTipY_FW_Raw_N = <0xfffffdc6 0xfffffdc6 0xfffffdc6 0xfffffdc6 0xfffffdc6 0xfffffdc6 0xfffffdc6 0xfffffdc6 0xfffffdc6 0xfffffdc6 0xfffffdc6 0xfffffdc6 0xfffffdc6 0xfffffdc6 0xfffffdc6 0xfffffdc6 0xfffffdc6 0xfffffdc6 0xfffffdc6 0xfffffdc6 0xfffffdc6 0xfffffdc6 0xfffffdc6 0xfffffdc6 0xfffffdc6 0xfffffdc6 0xfffffdc6 0xfffffdc6 0xfffffdc6 0xfffffdc6 0xfffffdc6 0xfffffdc6 0xfffffdc6 0xfffffdc6 0xfffffdc6 0xfffffdc6 0xfffffdc6 0xfffffdc6 0xfffffdc6 0xfffffdc6 0xfffffdc6 0xfffffdc6 0xfffffdc6 0xfffffdc6 0xfffffdc6 0xfffffdc6 0xfffffdc6 0xfffffdc6 0xfffffdc6 0xfffffdc6 0xfffffdc6 0xfffffdc6 0xfffffdc6 0xfffffdc6 0xfffffdc6 0xfffffdc6 0xfffffdc6 0xfffffdc6 0xfffffdc6 0xfffffdc6 0xfffffdc6 0xfffffdc6 0xfffffdc6 0xfffffdc6 0xfffffdc6 0xfffffdc6 0xfffffdc6 0xfffffdc6 0xfffffdc6 0xfffffdc6 0xfffffdc6 0xfffffdc6 0xfffffdc6 0xfffffdc6 0xfffffdc6 0xfffffdc6 0xfffffdc6 0xfffffdc6 0xfffffdc6 0xfffffdc6 0xfffffdc6 0xfffffdc6 0xfffffdc6 0xfffffdc6 0xfffffdc6 0xfffffdc6 0xfffffdc6 0xfffffdc6 0xfffffdc6 0xfffffdc6 0xfffffdc6 0xfffffdc6 0xfffffdc6 0xfffffdc6 0xfffffdc6 0xfffffdc6 0xfffffdc6 0xfffffdc6 0xfffffdc6 0xfffffdc6 0xfffffdc6 0xfffffdc6 0xfffffdc6 0xfffffdc6 0xfffffdc6 0xfffffdc6 0xfffffdc6 0xfffffdc6 0xfffffdc6 0xfffffdc6 0xfffffdc6 0xfffffdc6 0xfffffdc6 0xfffffdc6 0xfffffdc6 0xfffffdc6 0xfffffdc6 0xfffffdc6 0xfffffdc6 0xfffffdc6 0xfffffdc6 0xfffffdc6 0xfffffdc6 0xfffffdc6 0xfffffdc6 0xfffffdc6 0xfffffdc6 0xfffffdc6 0xfffffdc6 0xfffffdc6 0xfffffdc6 0xfffffdc6 0xfffffdc6 0xfffffdc6 0xfffffdc6 0xfffffdc6 0xfffffdc6 0xfffffdc6 0xfffffdc6 0xfffffdc6 0xfffffdc6 0xfffffdc6 0xfffffdc6 0xfffffdc6 0xfffffdc6 0xfffffdc6 0xfffffdc6 0xfffffdc6 0xfffffdc6 0xfffffdc6 0xfffffdc6 0xfffffdc6 0xfffffdc6 0xfffffdc6 0xfffffdc6 0xfffffdc6 0xfffffdc6 0xfffffdc6 0xfffffdc6 0xfffffdc6 0xfffffdc6 0xfffffdc6 0xfffffdc6 0xfffffdc6 0xfffffdc6 0xfffffdc6 0xfffffdc6 0xfffffdc6 0xfffffdc6 0xfffffdc6 0xfffffdc6 0xfffffdc6 0xfffffdc6 0xfffffdc6 0xfffffdc6 0xfffffdc6 0xfffffdc6 0xfffffdc6 0xfffffdc6 0xfffffdc6 0xfffffdc6 0xfffffdc6 0xfffffdc6 0xfffffdc6 0xfffffdc6 0xfffffdc6 0xfffffdc6 0xfffffdc6 0xfffffdc6 0xfffffdc6 0xfffffdc6 0xfffffdc6 0xfffffdc6 0xfffffdc6 0xfffffdc6 0xfffffdc6 0xfffffdc6 0xfffffdc6 0xfffffdc6 0xfffffdc6>;
					PS_Config_Lmt_PenTipY_FW_Raw_P = <0x23a 0x23a 0x23a 0x23a 0x23a 0x23a 0x23a 0x23a 0x23a 0x23a 0x23a 0x23a 0x23a 0x23a 0x23a 0x23a 0x23a 0x23a 0x23a 0x23a 0x23a 0x23a 0x23a 0x23a 0x23a 0x23a 0x23a 0x23a 0x23a 0x23a 0x23a 0x23a 0x23a 0x23a 0x23a 0x23a 0x23a 0x23a 0x23a 0x23a 0x23a 0x23a 0x23a 0x23a 0x23a 0x23a 0x23a 0x23a 0x23a 0x23a 0x23a 0x23a 0x23a 0x23a 0x23a 0x23a 0x23a 0x23a 0x23a 0x23a 0x23a 0x23a 0x23a 0x23a 0x23a 0x23a 0x23a 0x23a 0x23a 0x23a 0x23a 0x23a 0x23a 0x23a 0x23a 0x23a 0x23a 0x23a 0x23a 0x23a 0x23a 0x23a 0x23a 0x23a 0x23a 0x23a 0x23a 0x23a 0x23a 0x23a 0x23a 0x23a 0x23a 0x23a 0x23a 0x23a 0x23a 0x23a 0x23a 0x23a 0x23a 0x23a 0x23a 0x23a 0x23a 0x23a 0x23a 0x23a 0x23a 0x23a 0x23a 0x23a 0x23a 0x23a 0x23a 0x23a 0x23a 0x23a 0x23a 0x23a 0x23a 0x23a 0x23a 0x23a 0x23a 0x23a 0x23a 0x23a 0x23a 0x23a 0x23a 0x23a 0x23a 0x23a 0x23a 0x23a 0x23a 0x23a 0x23a 0x23a 0x23a 0x23a 0x23a 0x23a 0x23a 0x23a 0x23a 0x23a 0x23a 0x23a 0x23a 0x23a 0x23a 0x23a 0x23a 0x23a 0x23a 0x23a 0x23a 0x23a 0x23a 0x23a 0x23a 0x23a 0x23a 0x23a 0x23a 0x23a 0x23a 0x23a 0x23a 0x23a 0x23a 0x23a 0x23a 0x23a 0x23a 0x23a 0x23a 0x23a 0x23a 0x23a 0x23a 0x23a 0x23a 0x23a 0x23a 0x23a 0x23a 0x23a 0x23a 0x23a 0x23a 0x23a 0x23a 0x23a 0x23a 0x23a 0x23a 0x23a>;
					PS_Config_Lmt_Short_Rawdata_N = <0x2774 0x2774 0x2774 0x2774 0x2774 0x2774 0x2774 0x2774 0x2774 0x2774 0x2774 0x2774 0x2774 0x2774 0x2774 0x2774 0x2774 0x2774 0x2774 0x2774 0x2774 0x2774 0x2774 0x2774 0x2774 0x2774 0x2774 0x2774 0x2774 0x2774 0x2774 0x2774 0x2774 0x2774 0x2774 0x2774 0x2774 0x2774 0x2774 0x2774 0x2774 0x2774 0x2774 0x2774 0x2774 0x2774 0x2774 0x2774 0x2774 0x2774 0x2774 0x2774 0x2774 0x2774 0x2774 0x2774 0x2774 0x2774 0x2774 0x2774 0x2774 0x2774 0x2774 0x2774 0x2774 0x2774 0x2774 0x2774 0x2774 0x2774 0x2774 0x2774 0x2774 0x2774 0x2774 0x2774 0x2774 0x2774 0x2774 0x2774 0x2774 0x2774 0x2774 0x2774 0x2774 0x2774 0x2774 0x2774 0x2774 0x2774 0x2774 0x2774 0x2774 0x2774 0x2774 0x2774 0x2774 0x2774 0x2774 0x2774 0x2774 0x2774 0x2774 0x2774 0x2774 0x2774 0x2774 0x2774 0x2774 0x2774 0x2774 0x2774 0x2774 0x2774 0x2774 0x2774 0x2774 0x2774 0x2774 0x2774 0x2774 0x2774 0x2774 0x2774 0x2774 0x2774 0x2774 0x2774 0x2774 0x2774 0x2774 0x2774 0x2774 0x2774 0x2774 0x2774 0x2774 0x2774 0x2774 0x2774 0x2774 0x2774 0x2774 0x2774 0x2774 0x2774 0x2774 0x2774 0x2774 0x2774 0x2774 0x2774 0x2774 0x2774 0x2774 0x2774 0x2774 0x2774 0x2774 0x2774 0x2774 0x2774 0x2774 0x2774 0x2774 0x2774 0x2774 0x2774 0x2774 0x2774 0x2774 0x2774 0x2774 0x2774 0x2774 0x2774 0x2774 0x2774 0x2774 0x2774 0x2774 0x2774 0x2774 0x2774 0x2774 0x2774 0x2774 0x2774 0x2774 0x2774 0x2774 0x2774 0x2774 0x2774 0x2774 0x2774 0x2774 0x2774 0x2774 0x2774 0x2774 0x2774 0x2774 0x2774 0x2774 0x2774 0x2774 0x2774 0x2774 0x2774 0x2774 0x2774 0x2774 0x2774 0x2774 0x2774 0x2774 0x2774 0x2774 0x2774 0x2774 0x2774 0x2774 0x2774 0x2774 0x2774 0x2774 0x2774 0x2774 0x2774 0x2774 0x2774 0x2774 0x2774 0x2774 0x2774 0x2774 0x2774 0x2774 0x2774 0x2774 0x2774 0x2774 0x2774 0x2774 0x2774 0x2774 0x2774 0x2774 0x2774 0x2774 0x2774 0x2774 0x2774 0x2774 0x2774 0x2774 0x2774 0x2774 0x2774 0x2774 0x2774 0x2774 0x2774 0x2774 0x2774 0x2774 0x2774 0x2774 0x2774 0x2774 0x2774 0x2774 0x2774 0x2774 0x2774 0x2774 0x2774 0x2774 0x2774 0x2774 0x2774 0x2774 0x2774 0x2774 0x2774 0x2774 0x2774 0x2774 0x2774 0x2774 0x2774 0x2774 0x2774 0x2774 0x2774 0x2774 0x2774 0x2774 0x2774 0x2774 0x2774 0x2774 0x2774 0x2774 0x2774 0x2774 0x2774 0x2774 0x2774 0x2774 0x2774 0x2774 0x2774 0x2774 0x2774 0x2774 0x2774 0x2774 0x2774 0x2774 0x2774 0x2774 0x2774 0x2774 0x2774 0x2774 0x2774 0x2774 0x2774 0x2774 0x2774 0x2774 0x2774 0x2774 0x2774 0x2774 0x2774 0x2774 0x2774 0x2774 0x2774 0x2774 0x2774 0x2774 0x2774 0x2774 0x2774 0x2774 0x2774 0x2774 0x2774 0x2774 0x2774 0x2774 0x2774 0x2774 0x2774 0x2774 0x2774 0x2774 0x2774 0x2774 0x2774 0x2774 0x2774 0x2774 0x2774 0x2774 0x2774 0x2774 0x2774 0x2774 0x2774 0x2774 0x2774 0x2774 0x2774 0x2774 0x2774 0x2774 0x2774 0x2774 0x2774 0x2774 0x2774 0x2774 0x2774 0x2774 0x2774 0x2774 0x2774 0x2774 0x2774 0x2774 0x2774 0x2774 0x2774 0x2774 0x2774 0x2774 0x2774 0x2774 0x2774 0x2774 0x2774 0x2774 0x2774 0x2774 0x2774 0x2774 0x2774 0x2774 0x2774 0x2774 0x2774 0x2774 0x2774 0x2774 0x2774 0x2774 0x2774 0x2774 0x2774 0x2774 0x2774 0x2774 0x2774 0x2774 0x2774 0x2774 0x2774 0x2774 0x2774 0x2774 0x2774 0x2774 0x2774 0x2774 0x2774 0x2774 0x2774 0x2774 0x2774 0x2774 0x2774 0x2774 0x2774 0x2774 0x2774 0x2774 0x2774 0x2774 0x2774 0x2774 0x2774 0x2774 0x2774 0x2774 0x2774 0x2774 0x2774 0x2774 0x2774 0x2774 0x2774 0x2774 0x2774 0x2774 0x2774 0x2774 0x2774 0x2774 0x2774 0x2774 0x2774 0x2774 0x2774 0x2774 0x2774 0x2774 0x2774 0x2774 0x2774 0x2774 0x2774 0x2774 0x2774 0x2774 0x2774 0x2774 0x2774 0x2774 0x2774 0x2774 0x2774 0x2774 0x2774 0x2774 0x2774 0x2774 0x2774 0x2774 0x2774 0x2774 0x2774 0x2774 0x2774 0x2774 0x2774 0x2774 0x2774 0x2774 0x2774 0x2774 0x2774 0x2774 0x2774 0x2774 0x2774 0x2774 0x2774 0x2774 0x2774 0x2774 0x2774 0x2774 0x2774 0x2774 0x2774 0x2774 0x2774 0x2774 0x2774 0x2774 0x2774 0x2774 0x2774 0x2774 0x2774 0x2774 0x2774 0x2774 0x2774 0x2774 0x2774 0x2774 0x2774 0x2774 0x2774 0x2774 0x2774 0x2774 0x2774 0x2774 0x2774 0x2774 0x2774 0x2774 0x2774 0x2774 0x2774 0x2774 0x2774 0x2774 0x2774 0x2774 0x2774 0x2774 0x2774 0x2774 0x2774 0x2774 0x2774 0x2774 0x2774 0x2710 0x2710 0x2710>;
					PS_Config_Lmt_Short_Rawdata_P = <0x36b8 0x36b8 0x36b8 0x36b8 0x36b8 0x36b8 0x36b8 0x36b8 0x36b8 0x36b8 0x36b8 0x36b8 0x36b8 0x36b8 0x36b8 0x36b8 0x36b8 0x36b8 0x36b8 0x36b8 0x36b8 0x36b8 0x36b8 0x36b8 0x36b8 0x36b8 0x36b8 0x36b8 0x36b8 0x36b8 0x36b8 0x36b8 0x36b8 0x36b8 0x36b8 0x36b8 0x36b8 0x36b8 0x36b8 0x36b8 0x36b8 0x36b8 0x36b8 0x36b8 0x36b8 0x36b8 0x36b8 0x36b8 0x36b8 0x36b8 0x36b8 0x36b8 0x36b8 0x36b8 0x36b8 0x36b8 0x36b8 0x36b8 0x36b8 0x36b8 0x36b8 0x36b8 0x36b8 0x36b8 0x36b8 0x36b8 0x36b8 0x36b8 0x36b8 0x36b8 0x36b8 0x36b8 0x36b8 0x36b8 0x36b8 0x36b8 0x36b8 0x36b8 0x36b8 0x36b8 0x36b8 0x36b8 0x36b8 0x36b8 0x36b8 0x36b8 0x36b8 0x36b8 0x36b8 0x36b8 0x36b8 0x36b8 0x36b8 0x36b8 0x36b8 0x36b8 0x36b8 0x36b8 0x36b8 0x36b8 0x36b8 0x36b8 0x36b8 0x36b8 0x36b8 0x36b8 0x36b8 0x36b8 0x36b8 0x36b8 0x36b8 0x36b8 0x36b8 0x36b8 0x36b8 0x36b8 0x36b8 0x36b8 0x36b8 0x36b8 0x36b8 0x36b8 0x36b8 0x36b8 0x36b8 0x36b8 0x36b8 0x36b8 0x36b8 0x36b8 0x36b8 0x36b8 0x36b8 0x36b8 0x36b8 0x36b8 0x36b8 0x36b8 0x36b8 0x36b8 0x36b8 0x36b8 0x36b8 0x36b8 0x36b8 0x36b8 0x36b8 0x36b8 0x36b8 0x36b8 0x36b8 0x36b8 0x36b8 0x36b8 0x36b8 0x36b8 0x36b8 0x36b8 0x36b8 0x36b8 0x36b8 0x36b8 0x36b8 0x36b8 0x36b8 0x36b8 0x36b8 0x36b8 0x36b8 0x36b8 0x36b8 0x36b8 0x36b8 0x36b8 0x36b8 0x36b8 0x36b8 0x36b8 0x36b8 0x36b8 0x36b8 0x36b8 0x36b8 0x36b8 0x36b8 0x36b8 0x36b8 0x36b8 0x36b8 0x36b8 0x36b8 0x36b8 0x36b8 0x36b8 0x36b8 0x36b8 0x36b8 0x36b8 0x36b8 0x36b8 0x36b8 0x36b8 0x36b8 0x36b8 0x36b8 0x36b8 0x36b8 0x36b8 0x36b8 0x36b8 0x36b8 0x36b8 0x36b8 0x36b8 0x36b8 0x36b8 0x36b8 0x36b8 0x36b8 0x36b8 0x36b8 0x36b8 0x36b8 0x36b8 0x36b8 0x36b8 0x36b8 0x36b8 0x36b8 0x36b8 0x36b8 0x36b8 0x36b8 0x36b8 0x36b8 0x36b8 0x36b8 0x36b8 0x36b8 0x36b8 0x36b8 0x36b8 0x36b8 0x36b8 0x36b8 0x36b8 0x36b8 0x36b8 0x36b8 0x36b8 0x36b8 0x36b8 0x36b8 0x36b8 0x36b8 0x36b8 0x36b8 0x36b8 0x36b8 0x36b8 0x36b8 0x36b8 0x36b8 0x36b8 0x36b8 0x36b8 0x36b8 0x36b8 0x36b8 0x36b8 0x36b8 0x36b8 0x36b8 0x36b8 0x36b8 0x36b8 0x36b8 0x36b8 0x36b8 0x36b8 0x36b8 0x36b8 0x36b8 0x36b8 0x36b8 0x36b8 0x36b8 0x36b8 0x36b8 0x36b8 0x36b8 0x36b8 0x36b8 0x36b8 0x36b8 0x36b8 0x36b8 0x36b8 0x36b8 0x36b8 0x36b8 0x36b8 0x36b8 0x36b8 0x36b8 0x36b8 0x36b8 0x36b8 0x36b8 0x36b8 0x36b8 0x36b8 0x36b8 0x36b8 0x36b8 0x36b8 0x36b8 0x36b8 0x36b8 0x36b8 0x36b8 0x36b8 0x36b8 0x36b8 0x36b8 0x36b8 0x36b8 0x36b8 0x36b8 0x36b8 0x36b8 0x36b8 0x36b8 0x36b8 0x36b8 0x36b8 0x36b8 0x36b8 0x36b8 0x36b8 0x36b8 0x36b8 0x36b8 0x36b8 0x36b8 0x36b8 0x36b8 0x36b8 0x36b8 0x36b8 0x36b8 0x36b8 0x36b8 0x36b8 0x36b8 0x36b8 0x36b8 0x36b8 0x36b8 0x36b8 0x36b8 0x36b8 0x36b8 0x36b8 0x36b8 0x36b8 0x36b8 0x36b8 0x36b8 0x36b8 0x36b8 0x36b8 0x36b8 0x36b8 0x36b8 0x36b8 0x36b8 0x36b8 0x36b8 0x36b8 0x36b8 0x36b8 0x36b8 0x36b8 0x36b8 0x36b8 0x36b8 0x36b8 0x36b8 0x36b8 0x36b8 0x36b8 0x36b8 0x36b8 0x36b8 0x36b8 0x36b8 0x36b8 0x36b8 0x36b8 0x36b8 0x36b8 0x36b8 0x36b8 0x36b8 0x36b8 0x36b8 0x36b8 0x36b8 0x36b8 0x36b8 0x36b8 0x36b8 0x36b8 0x36b8 0x36b8 0x36b8 0x36b8 0x36b8 0x36b8 0x36b8 0x36b8 0x36b8 0x36b8 0x36b8 0x36b8 0x36b8 0x36b8 0x36b8 0x36b8 0x36b8 0x36b8 0x36b8 0x36b8 0x36b8 0x36b8 0x36b8 0x36b8 0x36b8 0x36b8 0x36b8 0x36b8 0x36b8 0x36b8 0x36b8 0x36b8 0x36b8 0x36b8 0x36b8 0x36b8 0x36b8 0x36b8 0x36b8 0x36b8 0x36b8 0x36b8 0x36b8 0x36b8 0x36b8 0x36b8 0x36b8 0x36b8 0x36b8 0x36b8 0x36b8 0x36b8 0x36b8 0x36b8 0x36b8 0x36b8 0x36b8 0x36b8 0x36b8 0x36b8 0x36b8 0x36b8 0x36b8 0x36b8 0x36b8 0x36b8 0x36b8 0x36b8 0x36b8 0x36b8 0x36b8 0x36b8 0x36b8 0x36b8 0x36b8 0x36b8 0x36b8 0x36b8 0x36b8 0x36b8 0x36b8 0x36b8 0x36b8 0x36b8 0x36b8 0x36b8 0x36b8 0x36b8 0x36b8 0x36b8 0x36b8 0x36b8 0x36b8 0x36b8 0x36b8 0x36b8 0x36b8 0x36b8 0x36b8 0x36b8 0x36b8 0x36b8 0x36b8 0x36b8 0x36b8 0x36b8 0x36b8 0x36b8 0x36b8 0x36b8 0x36b8 0x36b8 0x36b8 0x36b8 0x36b8 0x36b8 0x36b8 0x36b8 0x36b8 0x36b8 0x36b8 0x36b8 0x36b8 0x36b8 0x36b8 0x36b8 0x36b8 0x36b8 0x36b8 0x36b8 0x36b8 0x36b8 0x36b8 0x36b8 0x36b8 0x36b8 0x36b8 0x36b8 0x36b8 0x36b8 0x36b8 0x36b8 0x36b8 0x36b8 0x36b8 0x36b8 0x36b8 0x36b8 0x36b8 0x36b8 0x36b8 0x36b8 0x36b8 0x36b8 0x36b8 0x36b8 0x36b8 0x36b8 0x36b8 0x36b8 0x36b8 0x36b8 0x36b8 0x36b8 0x36b8>;
					X_Channel = <0x12>;
					Y_Channel = <0x20>;
					compatible = "novatek-mp-criteria-6282";
				};
			};
		};
	};

	fragment@16 {
		target = <0xffffffff>;

		__overlay__ {
			compatible = "mediatek,touch";
			pinctrl-0 = <0xb>;
			pinctrl-1 = <0xc>;
			pinctrl-2 = <0xd>;
			pinctrl-3 = <0xe>;
			pinctrl-4 = <0xf>;
			pinctrl-5 = <0x10>;
			pinctrl-names = "default", "state_eint_as_int", "state_eint_output0", "state_eint_output1", "state_rst_output0", "state_rst_output1";
			status = "okay";
			tpd-filter-custom-prameters = <0x0 0x0 0x0 0x0 0x0 0x0 0x0 0x0 0x0 0x0 0x0 0x0>;
			tpd-filter-custom-speed = <0x0 0x0 0x0>;
			tpd-filter-enable = <0x0>;
			tpd-filter-pixel-density = <0x92>;
			tpd-key-dim-local = <0x5a 0x373 0x64 0x28 0xe6 0x373 0x64 0x28 0x172 0x373 0x64 0x28 0x0 0x0 0x0 0x0>;
			tpd-key-local = <0x8b 0xac 0x9e 0x0>;
			tpd-key-num = <0x3>;
			tpd-max-touch-num = <0x5>;
			tpd-resolution = <0x2d0 0x64c>;
			use-tpd-button = <0x0>;
		};
	};

	fragment@17 {
		target = <0xffffffff>;

		__overlay__ {

			eint0default {
				phandle = <0xb>;
			};

			eint@0 {
				phandle = <0xc>;

				pins_cmd_dat {
					bias-disable;
					pinmux = <0x400>;
					slew-rate = <0x0>;
				};
			};

			eintoutput0 {
				phandle = <0xd>;

				pins_cmd_dat {
					output-low;
					pinmux = <0x400>;
					slew-rate = <0x1>;
				};
			};

			eintoutput1 {
				phandle = <0xe>;

				pins_cmd_dat {
					output-high;
					pinmux = <0x400>;
					slew-rate = <0x1>;
				};
			};

			rstoutput0 {
				phandle = <0xf>;

				pins_cmd_dat {
					output-low;
					pinmux = <0xae00>;
					slew-rate = <0x1>;
				};
			};

			rstoutput1 {
				phandle = <0x10>;

				pins_cmd_dat {
					output-high;
					pinmux = <0xae00>;
					slew-rate = <0x1>;
				};
			};
		};
	};

	fragment@18 {
		target = <0xffffffff>;

		__overlay__ {
			pinctrl-0 = <0x11>;
			pinctrl-names = "default";
		};
	};

	fragment@19 {
		target = <0xffffffff>;

		__overlay__ {

			kpdgpiodefault {
				phandle = <0x11>;

				pins_cmd_dat {
					bias-pull-up = <0x66>;
					input-schmitt-enable;
					output-low;
					pinmux = <0x5d01>;
				};
			};
		};
	};

	fragment@2 {
		target = <0xffffffff>;

		__overlay__ {
			#address-cells = <0x1>;
			#size-cells = <0x0>;
			clock-frequency = <0x61a80>;

			mtk-usb@60 {
				compatible = "mediatek,mtk-usb";
				reg = <0x60>;
				status = "okay";
			};
		};
	};

	fragment@20 {
		target = <0xffffffff>;

		__overlay__ {
			accdet-mic-mode = <0x1>;
			accdet-mic-vol = <0x6>;
			accdet-plugout-debounce = <0x1>;
			headset-eint-level-pol = <0x8>;
			headset-four-key-threshold = <0x0 0x3a 0x79 0xc0 0x190>;
			headset-mode-setting = <0x500 0x500 0x1 0x1f0 0x800 0x800 0x20 0x44>;
			headset-three-key-threshold = <0x0 0x50 0xdc 0x190>;
			headset-three-key-threshold-CDD = <0x0 0x79 0xc0 0x258>;
			pinctrl-0 = <0x12>;
			pinctrl-1 = <0x13>;
			pinctrl-names = "default", "state_eint_as_int";
			status = "okay";
		};
	};

	fragment@21 {
		target = <0xffffffff>;

		__overlay__ {

			accdetdefault {
				phandle = <0x12>;
			};

			accdeteint@0 {
				phandle = <0x13>;

				pins_cmd_dat {
					bias-disable;
					pinmux = <0x900>;
					slew-rate = <0x0>;
				};
			};
		};
	};

	fragment@22 {
		target = <0xffffffff>;

		__overlay__ {

			consys_default {
				phandle = <0x14>;
			};

			gpslna@0 {
				phandle = <0x15>;

				pins_cmd_dat {
					bias-disable;
					output-low;
					pinmux = <0x5b00>;
					slew-rate = <0x0>;
				};
			};

			gpslna@1 {
				phandle = <0x16>;

				pins_cmd_dat {
					output-high;
					pinmux = <0x5b00>;
					slew-rate = <0x1>;
				};
			};

			gpslna@2 {
				phandle = <0x17>;

				pins_cmd_dat {
					output-low;
					pinmux = <0x5b00>;
					slew-rate = <0x1>;
				};
			};
		};
	};

	fragment@23 {
		target = <0xffffffff>;

		__overlay__ {
			pinctrl-0 = <0x14>;
			pinctrl-1 = <0x15>;
			pinctrl-2 = <0x16>;
			pinctrl-3 = <0x17>;
			pinctrl-names = "default", "gps_lna_state_init", "gps_lna_state_oh", "gps_lna_state_ol";
			status = "okay";
		};
	};

	fragment@24 {
		target = <0xffffffff>;

		__overlay__ {
			pinctrl-0 = <0x18>;
			pinctrl-1 = <0x19>;
			pinctrl-2 = <0x1a>;
			pinctrl-3 = <0x1b>;
			pinctrl-4 = <0x1c>;
			pinctrl-5 = <0x1d>;
			pinctrl-6 = <0x1e>;
			pinctrl-7 = <0x1f>;
			pinctrl-8 = <0x20>;
			pinctrl-9 = <0x21>;
			pinctrl-names = "aud_clk_mosi_off", "aud_clk_mosi_on", "aud_clk_miso_off", "aud_clk_miso_on", "aud_dat_mosi_off", "aud_dat_mosi_on", "aud_dat_miso_off", "aud_dat_miso_on", "aud_extamp-pullhigh", "aud_extamp-pulllow";
			status = "okay";
		};
	};

	fragment@25 {
		target = <0xffffffff>;

		__overlay__ {

			aud_clk_miso_off {
				phandle = <0x1a>;

				pins_cmd0_dat {
					pinmux = <0x8c00>;
				};
			};

			aud_clk_miso_on {
				phandle = <0x1b>;

				pins_cmd0_dat {
					pinmux = <0x8c01>;
				};
			};

			aud_clk_mosi_off {
				phandle = <0x18>;

				pins_cmd0_dat {
					pinmux = <0x8800>;
				};
			};

			aud_clk_mosi_on {
				phandle = <0x19>;

				pins_cmd0_dat {
					pinmux = <0x8801>;
				};
			};

			aud_dat_miso_off {
				phandle = <0x1e>;

				pins_cmd1_dat {
					bias-disable;
					input-enable;
					pinmux = <0x8e00>;
					slew-rate = <0x0>;
				};

				pins_cmd2_dat {
					bias-disable;
					input-enable;
					pinmux = <0x8f00>;
					slew-rate = <0x0>;
				};
			};

			aud_dat_miso_on {
				phandle = <0x1f>;

				pins_cmd1_dat {
					pinmux = <0x8e01>;
				};

				pins_cmd2_dat {
					pinmux = <0x8f01>;
				};
			};

			aud_dat_mosi_off {
				phandle = <0x1c>;

				pins_cmd1_dat {
					bias-disable;
					input-enable;
					pinmux = <0x8a00>;
					slew-rate = <0x0>;
				};

				pins_cmd2_dat {
					bias-disable;
					input-enable;
					pinmux = <0x8b00>;
					slew-rate = <0x0>;
				};
			};

			aud_dat_mosi_on {
				phandle = <0x1d>;

				pins_cmd1_dat {
					pinmux = <0x8a01>;
				};

				pins_cmd2_dat {
					pinmux = <0x8b01>;
				};
			};

			audexamphigh {
				phandle = <0x20>;

				pins_cmd_dat {
					output-high;
					pinmux = <0x9700>;
					slew-rate = <0x1>;
				};
			};

			audexamplow {
				phandle = <0x21>;

				pins_cmd_dat {
					output-low;
					pinmux = <0x9700>;
					slew-rate = <0x1>;
				};
			};
		};
	};

	fragment@26 {
		target = <0xffffffff>;

		__overlay__ {
			charger = <0xffffffff>;
			vbus-supply;
		};
	};

	fragment@27 {
		target = <0xffffffff>;

		__overlay__ {

			camled0@1 {
				phandle = <0x23>;

				pins_cmd_dat {
					output-high;
					pinmux = <0x9800>;
					slew-rate = <0x1>;
				};
			};

			camled0@2 {
				phandle = <0x24>;

				pins_cmd_dat {
					output-low;
					pinmux = <0x9800>;
					slew-rate = <0x1>;
				};
			};

			camled0@3 {
				phandle = <0x25>;

				pins_cmd_dat {
					output-high;
					pinmux = <0xc00>;
					slew-rate = <0x1>;
				};
			};

			camled0@4 {
				phandle = <0x26>;

				pins_cmd_dat {
					output-low;
					pinmux = <0xc00>;
					slew-rate = <0x1>;
				};
			};

			flashlightdefault {
				phandle = <0x22>;
			};
		};
	};

	fragment@28 {
		target = <0xffffffff>;

		__overlay__ {
			pinctrl-0 = <0x22>;
			pinctrl-1 = <0x23>;
			pinctrl-2 = <0x24>;
			pinctrl-3 = <0x25>;
			pinctrl-4 = <0x26>;
			pinctrl-names = "default", "en_torch_high", "en_torch_low", "en_flash_high", "en_flash_low";
			status = "okay";
		};
	};

	fragment@29 {
		target = <0xffffffff>;

		__overlay__ {

			fingerprint@0 {
				compatible = "tran_fp";
				debounce = <0x8 0x0>;
				interrupt-parent = <0xffffffff>;
				interrupts = <0x8 0x1 0x8 0x0>;
				irq-gpio = <0x8>;
				irq-gpio-std = <0xffffffff 0x8 0x0>;
				pinctrl-0 = <0x27>;
				pinctrl-1 = <0x28>;
				pinctrl-2 = <0x29>;
				pinctrl-3 = <0x2a>;
				pinctrl-4 = <0x2b>;
				pinctrl-names = "tran_fp_default", "tran_fp_pin_irq", "tran_fp_irq_pull_down", "tran_fp_reset_high", "tran_fp_reset_low";
				reg = <0x0>;
				reset-gpio = <0x18>;
				reset-gpio-std = <0xffffffff 0x18 0x0>;
				spi-max-frequency = <0x19bfcc0>;
				status = "okay";
			};
		};
	};

	fragment@3 {
		target = <0xffffffff>;

		__overlay__ {

			camera_main_eeprom@50 {
				compatible = "mediatek,camera_main_eeprom";
				reg = <0x50>;
			};
		};
	};

	fragment@30 {
		target = <0xffffffff>;

		__overlay__ {

			fingerprint_default {
				phandle = <0x27>;
			};

			gpio8_eint {
				phandle = <0x28>;

				pins_cmd_dat {
					bias-disable;
					pinmux = <0x800>;
					slew-rate = <0x0>;
				};
			};

			gpio8_eint_pull_down {
				phandle = <0x29>;

				pins_cmd_dat {
					bias-pull-down = <0x0>;
					output-low;
					pinmux = <0x800>;
					slew-rate = <0x0>;
				};
			};

			rst_out_one {
				phandle = <0x2a>;

				pins_cmd_dat {
					bias-disable;
					output-high;
					pinmux = <0x1800>;
					slew-rate = <0x1>;
				};
			};

			rst_out_zero {
				phandle = <0x2b>;

				pins_cmd_dat {
					bias-disable;
					output-low;
					pinmux = <0x1800>;
					slew-rate = <0x1>;
				};
			};
		};
	};

	fragment@31 {
		target = <0xffffffff>;

		__overlay__ {

			adc_channel@ {
				compatible = "mediatek,adc_channel";
				mediatek,adc_fdd_rf_params_dynamic_custom_ch = <0x2>;
				mediatek,temperature0 = <0x0>;
				mediatek,temperature1 = <0x1>;
				status = "okay";
			};
		};
	};

	fragment@32 {
		target = <0xffffffff>;

		__overlay__ {
			io-channels = <0xffffffff 0x2>;
		};
	};

	fragment@33 {
		target = <0xffffffff>;

		__overlay__ {
			mediatek,clkbuf-config = <0x2 0x1 0x1 0x2 0x0 0x0 0x0>;
			mediatek,clkbuf-driving-current = <0x1 0x1 0x1 0x1 0x1 0x1 0x1>;
			mediatek,clkbuf-quantity = <0x7>;
			status = "okay";
		};
	};

	fragment@34 {
		target = <0xffffffff>;

		__overlay__ {
			#address-cells = <0x1>;
			#size-cells = <0x0>;
			clock-frequency = <0x61a80>;
			mediatek,use-open-drain;
		};
	};

	fragment@35 {
		target = <0xffffffff>;

		__overlay__ {
			#address-cells = <0x1>;
			#size-cells = <0x0>;
			clock-frequency = <0x61a80>;
			mediatek,use-open-drain;

			alsps@23 {
				compatible = "mediatek,alsps";
				interrupt-parent = <0xffffffff>;
				interrupts = <0x6 0x8 0x6 0x0>;
				phandle = <0x4f>;
				reg = <0x23>;
				status = "okay";
			};

			gsensor@15 {
				compatible = "mediatek,gsensor";
				phandle = <0x50>;
				reg = <0x15>;
				status = "okay";
			};
		};
	};

	fragment@36 {
		target = <0xffffffff>;

		__overlay__ {
			#address-cells = <0x1>;
			#size-cells = <0x0>;
			clock-frequency = <0x61a80>;
			mediatek,use-open-drain;

			camera_main@1a {
				compatible = "mediatek,camera_main";
				phandle = <0x51>;
				reg = <0x1a>;
				status = "okay";
			};

			camera_main_af@72 {
				compatible = "mediatek,camera_main_af";
				phandle = <0x52>;
				reg = <0x72>;
				status = "okay";
			};
		};
	};

	fragment@37 {
		target = <0xffffffff>;

		__overlay__ {
			#address-cells = <0x1>;
			#size-cells = <0x0>;
			clock-frequency = <0x61a80>;
			mediatek,use-open-drain;

			ext_buck_lp4@57 {
				compatible = "mediatek,ext_buck_lp4";
				phandle = <0x53>;
				reg = <0x57>;
				status = "okay";
			};

			ext_buck_lp4x@50 {
				compatible = "mediatek,ext_buck_lp4x";
				phandle = <0x54>;
				reg = <0x50>;
				status = "okay";
			};
		};
	};

	fragment@38 {
		target = <0xffffffff>;

		__overlay__ {
			#address-cells = <0x1>;
			#size-cells = <0x0>;
			clock-frequency = <0x61a80>;
			mediatek,use-open-drain;

			camera_sub@2d {
				compatible = "mediatek,camera_sub";
				phandle = <0x55>;
				reg = <0x2d>;
				status = "okay";
			};
		};
	};

	fragment@39 {
		target = <0xffffffff>;

		__overlay__ {
			#address-cells = <0x1>;
			#size-cells = <0x0>;
			clock-frequency = <0x30d40>;
			mediatek,use-open-drain;

			i2c_lcd_bias@3e {
				compatible = "mediatek,i2c_lcd_bias";
				phandle = <0x56>;
				reg = <0x3e>;
				status = "okay";
			};

			strobe_main@63 {
				compatible = "mediatek,strobe_main";
				phandle = <0x57>;
				reg = <0x63>;
				status = "okay";
			};
		};
	};

	fragment@4 {
		target = <0xffffffff>;

		__overlay__ {

			ext_buck_lp4@57 {
				regulator-max-microvolt = <0x13d620>;
				regulator-min-microvolt = <0x493e0>;
				regulator-name = "ext_buck_vdd2";
				vsel_pin = <0x0>;
			};

			ext_buck_lp4x@50 {
				regulator-max-microvolt = <0x13d620>;
				regulator-min-microvolt = <0x493e0>;
				regulator-name = "ext_buck_vddq";
				vsel_pin = <0x1>;
			};
		};
	};

	fragment@40 {
		target = <0xffffffff>;

		__overlay__ {
			#address-cells = <0x1>;
			#size-cells = <0x0>;
			clock-frequency = <0x61a80>;
			mediatek,use-open-drain;
		};
	};

	fragment@41 {
		target = <0xffffffff>;

		__overlay__ {
			#address-cells = <0x1>;
			#size-cells = <0x0>;
			clock-frequency = <0x61a80>;
			mediatek,use-open-drain;
		};
	};

	fragment@42 {
		target = <0xffffffff>;

		__overlay__ {
			#address-cells = <0x1>;
			#size-cells = <0x0>;
			clock-frequency = <0x61a80>;
			mediatek,use-open-drain;
		};
	};

	fragment@43 {
		target = <0xffffffff>;

		__overlay__ {
			#address-cells = <0x1>;
			#size-cells = <0x0>;
			clock-frequency = <0x61a80>;
			mediatek,use-open-drain;
		};
	};

	fragment@44 {
		target = <0xffffffff>;

		__overlay__ {
			GPIO_FDD_BAND_SUPPORT_DETECT_1ST_PIN = <0xffffffff 0x44 0x0>;
			GPIO_FDD_BAND_SUPPORT_DETECT_2ND_PIN = <0xffffffff 0x43 0x0>;
			GPIO_FDD_BAND_SUPPORT_DETECT_3RD_PIN = <0xffffffff 0x42 0x0>;
			GPIO_SIM1_HOT_PLUG = <0xffffffff 0x2f 0x0>;
			GPIO_SIM1_SCLK = <0xffffffff 0x26 0x0>;
			GPIO_SIM1_SIO = <0xffffffff 0x28 0x0>;
			GPIO_SIM1_SRST = <0xffffffff 0x27 0x0>;
			GPIO_SIM2_HOT_PLUG = <0xffffffff 0x2e 0x0>;
			GPIO_SIM2_SCLK = <0xffffffff 0x25 0x0>;
			GPIO_SIM2_SIO = <0xffffffff 0x23 0x0>;
			GPIO_SIM2_SRST = <0xffffffff 0x24 0x0>;
		};
	};

	fragment@45 {
		target = <0xffffffff>;

		__overlay__ {
			gpio_init_default = <0x0 0x0 0x0 0x0 0x1 0x1 0x1 0x1 0x0 0x1 0x0 0x1 0x0 0x1 0x2 0x0 0x0 0x0 0x1 0x1 0x1 0x3 0x0 0x0 0x0 0x1 0x0 0x1 0x4 0x0 0x0 0x0 0x1 0x1 0x0 0x5 0x0 0x0 0x0 0x1 0x1 0x0 0x6 0x0 0x0 0x0 0x1 0x1 0x0 0x7 0x0 0x0 0x0 0x1 0x0 0x0 0x8 0x0 0x0 0x0 0x1 0x0 0x0 0x9 0x0 0x0 0x0 0x1 0x0 0x1 0xa 0x0 0x0 0x0 0x1 0x0 0x1 0xb 0x0 0x0 0x0 0x0 0x0 0x1 0xc 0x0 0x1 0x0 0x1 0x0 0x0 0xd 0x0 0x0 0x0 0x1 0x0 0x0 0xe 0x0 0x0 0x0 0x1 0x0 0x0 0xf 0x0 0x0 0x0 0x1 0x0 0x0 0x10 0x0 0x0 0x0 0x1 0x0 0x0 0x11 0x2 0x0 0x0 0x1 0x0 0x0 0x12 0x2 0x0 0x0 0x1 0x0 0x0 0x13 0x2 0x0 0x0 0x1 0x0 0x0 0x14 0x2 0x0 0x0 0x1 0x0 0x0 0x15 0x0 0x0 0x0 0x1 0x0 0x0 0x16 0x0 0x0 0x0 0x1 0x0 0x0 0x17 0x0 0x0 0x0 0x1 0x0 0x0 0x18 0x0 0x1 0x0 0x1 0x0 0x0 0x19 0x0 0x0 0x0 0x1 0x0 0x0 0x1a 0x0 0x0 0x0 0x1 0x0 0x0 0x1b 0x0 0x0 0x0 0x1 0x0 0x0 0x1c 0x0 0x0 0x0 0x1 0x0 0x0 0x1d 0x1 0x0 0x0 0x1 0x0 0x1 0x1e 0x1 0x0 0x0 0x1 0x0 0x1 0x1f 0x1 0x0 0x0 0x1 0x0 0x1 0x20 0x1 0x0 0x0 0x1 0x0 0x1 0x21 0x1 0x0 0x0 0x1 0x0 0x1 0x22 0x1 0x0 0x0 0x1 0x0 0x1 0x23 0x1 0x0 0x0 0x1 0x1 0x0 0x24 0x1 0x0 0x0 0x0 0x0 0x0 0x25 0x1 0x0 0x0 0x0 0x0 0x0 0x26 0x1 0x0 0x0 0x0 0x0 0x0 0x27 0x1 0x0 0x0 0x0 0x0 0x0 0x28 0x1 0x0 0x0 0x1 0x1 0x0 0x29 0x0 0x0 0x0 0x1 0x1 0x0 0x2a 0x0 0x0 0x0 0x1 0x0 0x0 0x2b 0x1 0x0 0x0 0x0 0x0 0x0 0x2c 0x1 0x0 0x0 0x1 0x0 0x0 0x2d 0x0 0x1 0x0 0x1 0x0 0x0 0x2e 0x1 0x0 0x0 0x1 0x1 0x0 0x2f 0x1 0x0 0x0 0x1 0x1 0x0 0x30 0x1 0x0 0x0 0x1 0x1 0x1 0x31 0x1 0x0 0x0 0x1 0x1 0x1 0x32 0x1 0x0 0x0 0x1 0x1 0x1 0x33 0x1 0x0 0x0 0x1 0x1 0x1 0x34 0x0 0x0 0x0 0x1 0x0 0x0 0x35 0x0 0x0 0x0 0x1 0x0 0x0 0x36 0x1 0x0 0x0 0x1 0x0 0x0 0x37 0x1 0x0 0x0 0x1 0x0 0x0 0x38 0x1 0x0 0x0 0x1 0x0 0x0 0x39 0x1 0x0 0x0 0x1 0x0 0x0 0x3a 0x0 0x0 0x0 0x1 0x0 0x0 0x3b 0x1 0x0 0x0 0x1 0x0 0x0 0x3c 0x1 0x0 0x0 0x1 0x0 0x0 0x3d 0x1 0x0 0x0 0x1 0x0 0x0 0x3e 0x1 0x0 0x0 0x1 0x0 0x0 0x3f 0x1 0x0 0x0 0x1 0x0 0x0 0x40 0x1 0x0 0x0 0x1 0x0 0x0 0x41 0x0 0x0 0x0 0x1 0x0 0x0 0x42 0x0 0x0 0x0 0x1 0x0 0x0 0x43 0x0 0x0 0x0 0x1 0x0 0x0 0x44 0x0 0x0 0x0 0x1 0x0 0x0 0x45 0x1 0x0 0x0 0x1 0x0 0x0 0x46 0x1 0x0 0x0 0x1 0x0 0x0 0x47 0x0 0x0 0x0 0x1 0x0 0x0 0x48 0x1 0x0 0x0 0x1 0x0 0x0 0x49 0x1 0x0 0x0 0x1 0x0 0x0 0x4a 0x1 0x0 0x0 0x1 0x0 0x0 0x4b 0x1 0x0 0x0 0x1 0x0 0x0 0x4c 0x0 0x0 0x0 0x1 0x0 0x0 0x4d 0x0 0x0 0x0 0x1 0x0 0x0 0x4e 0x0 0x0 0x0 0x1 0x0 0x0 0x4f 0x0 0x0 0x0 0x1 0x0 0x0 0x50 0x0 0x0 0x0 0x1 0x0 0x0 0x51 0x1 0x0 0x0 0x1 0x1 0x1 0x52 0x1 0x0 0x0 0x1 0x1 0x1 0x53 0x1 0x0 0x0 0x1 0x1 0x1 0x54 0x1 0x0 0x0 0x1 0x1 0x1 0x55 0x1 0x0 0x0 0x1 0x0 0x0 0x56 0x1 0x0 0x0 0x1 0x0 0x0 0x57 0x0 0x1 0x1 0x1 0x0 0x0 0x58 0x0 0x1 0x0 0x1 0x0 0x0 0x59 0x0 0x0 0x0 0x1 0x0 0x0 0x5a 0x0 0x0 0x0 0x1 0x0 0x0 0x5b 0x0 0x1 0x0 0x1 0x0 0x0 0x5c 0x0 0x0 0x0 0x1 0x0 0x0 0x5d 0x1 0x0 0x0 0x1 0x1 0x0 0x5e 0x1 0x0 0x0 0x1 0x1 0x0 0x5f 0x1 0x0 0x0 0x1 0x1 0x0 0x60 0x1 0x0 0x0 0x0 0x0 0x0 0x61 0x0 0x1 0x0 0x1 0x0 0x0 0x62 0x0 0x1 0x0 0x1 0x0 0x0 0x63 0x1 0x0 0x0 0x0 0x0 0x0 0x64 0x1 0x0 0x0 0x0 0x0 0x0 0x65 0x0 0x1 0x1 0x1 0x0 0x0 0x66 0x0 0x1 0x1 0x1 0x0 0x0 0x67 0x1 0x0 0x0 0x1 0x1 0x1 0x68 0x1 0x0 0x0 0x1 0x1 0x1 0x69 0x1 0x0 0x0 0x1 0x1 0x1 0x6a 0x1 0x0 0x0 0x1 0x1 0x1 0x6b 0x0 0x0 0x0 0x1 0x0 0x0 0x6c 0x1 0x0 0x0 0x0 0x0 0x0 0x6d 0x0 0x0 0x0 0x1 0x0 0x0 0x6e 0x0 0x0 0x0 0x1 0x0 0x0 0x6f 0x0 0x0 0x0 0x1 0x0 0x0 0x70 0x0 0x0 0x0 0x1 0x0 0x0 0x71 0x1 0x0 0x0 0x1 0x0 0x0 0x72 0x1 0x0 0x0 0x1 0x0 0x0 0x73 0x1 0x0 0x0 0x1 0x0 0x0 0x74 0x1 0x0 0x0 0x1 0x0 0x0 0x75 0x1 0x0 0x0 0x1 0x0 0x0 0x76 0x1 0x0 0x0 0x1 0x0 0x0 0x77 0x1 0x0 0x0 0x1 0x0 0x0 0x78 0x1 0x0 0x0 0x1 0x0 0x0 0x79 0x1 0x0 0x0 0x1 0x0 0x0 0x86 0x1 0x0 0x0 0x1 0x0 0x1 0x87 0x1 0x0 0x0 0x0 0x0 0x0 0x88 0x1 0x0 0x0 0x0 0x0 0x0 0x89 0x1 0x0 0x0 0x0 0x0 0x0 0x8a 0x1 0x0 0x0 0x0 0x0 0x0 0x8b 0x1 0x0 0x0 0x0 0x0 0x0 0x8c 0x1 0x0 0x0 0x1 0x0 0x0 0x8d 0x1 0x0 0x0 0x1 0x0 0x0 0x8e 0x1 0x0 0x0 0x1 0x0 0x0 0x8f 0x1 0x0 0x0 0x1 0x0 0x0 0x90 0x1 0x0 0x0 0x1 0x0 0x0 0x91 0x1 0x0 0x0 0x0 0x0 0x0 0x92 0x1 0x0 0x0 0x1 0x0 0x0 0x93 0x1 0x0 0x0 0x0 0x0 0x0 0x94 0x1 0x0 0x0 0x0 0x0 0x0 0x95 0x1 0x0 0x0 0x0 0x0 0x0 0x96 0x0 0x1 0x0 0x1 0x0 0x0 0x97 0x0 0x1 0x0 0x1 0x0 0x0 0x98 0x0 0x1 0x0 0x1 0x0 0x0 0x99 0x0 0x1 0x0 0x1 0x0 0x0 0x9a 0x0 0x1 0x0 0x1 0x0 0x0 0x9b 0x1 0x0 0x0 0x0 0x0 0x0 0x9c 0x1 0x0 0x0 0x1 0x0 0x0 0x9d 0x1 0x0 0x0 0x1 0x0 0x0 0x9e 0x1 0x0 0x0 0x1 0x0 0x0 0x9f 0x0 0x1 0x0 0x1 0x0 0x0 0xa0 0x0 0x1 0x0 0x1 0x0 0x0 0xa1 0x1 0x0 0x0 0x1 0x0 0x1 0xa2 0x1 0x0 0x0 0x1 0x0 0x1 0xa3 0x0 0x0 0x0 0x1 0x0 0x0 0xa4 0x0 0x0 0x0 0x1 0x0 0x0 0xa5 0x0 0x0 0x0 0x1 0x0 0x0 0xa6 0x0 0x0 0x0 0x1 0x0 0x0 0xa7 0x0 0x0 0x0 0x1 0x0 0x0 0xa8 0x0 0x0 0x0 0x1 0x0 0x0 0xa9 0x0 0x0 0x0 0x1 0x0 0x0 0xaa 0x0 0x0 0x0 0x1 0x0 0x0 0xab 0x0 0x0 0x0 0x1 0x0 0x0 0xac 0x0 0x0 0x0 0x1 0x0 0x0 0xad 0x0 0x0 0x0 0x1 0x0 0x0 0xae 0x0 0x1 0x0 0x1 0x0 0x0 0xaf 0x0 0x0 0x0 0x1 0x0 0x0 0xb0 0x0 0x0 0x0 0x1 0x0 0x0 0xb1 0x0 0x0 0x0 0x1 0x0 0x0 0xb2 0x0 0x0 0x0 0x1 0x0 0x0 0xb3 0x0 0x0 0x0 0x1 0x0 0x0>;
		};
	};

	fragment@46 {
		target = <0xffffffff>;

		__overlay__ {
			deb-gpios = <0xffffffff 0x2 0x0>;
			debounce = <0x7d000>;
			interrupt-parent = <0xffffffff>;
			interrupts = <0x2 0x8 0x2 0x0>;
			status = "okay";
		};
	};

	fragment@47 {
		target = <0xffffffff>;

		__overlay__ {
			interrupt-parent = <0xffffffff>;
			interrupts = <0x4 0x2 0x4 0x0>;
			status = "okay";
		};
	};

	fragment@48 {
		target = <0xffffffff>;

		__overlay__ {
			interrupt-parent = <0xffffffff>;
			interrupts = <0x8 0x1 0x8 0x0>;
			status = "okay";
		};
	};

	fragment@49 {
		target = <0xffffffff>;

		__overlay__ {
			interrupt-parent = <0xffffffff>;
			interrupts = <0x29 0x8 0x29 0x0>;
			status = "okay";
		};
	};

	fragment@5 {
		target = <0xffffffff>;

		__overlay__ {

			aw32257@6b {
				compatible = "awinic,aw32257";
				reg = <0x6b>;
			};

			eta6937@6a {
				charger_name = "primary_chg";
				compatible = "mediatek,eta6937";
				reg = <0x6a>;
				status = "okay";
			};
		};
	};

	fragment@50 {
		target = <0xffffffff>;

		__overlay__ {
			interrupt-parent = <0xffffffff>;
			interrupts = <0x2c 0x1 0x2c 0x1>;
			status = "okay";
		};
	};

	fragment@51 {
		target = <0xffffffff>;

		__overlay__ {
			interrupt-parent = <0xffffffff>;
			interrupts = <0x90 0x4 0x90 0x1>;
			status = "okay";
		};
	};

	fragment@52 {
		target = <0xffffffff>;

		__overlay__ {
			compatible = "mediatek,md1_sim1_hot_plug_eint-eint";
			debounce = <0x0 0x2710>;
			dedicated = <0x0 0x0>;
			interrupts = <0x0 0x8>;
			sockettype = <0x0 0x0>;
			src_pin = <0x0 0x1>;
			status = "okay";
		};
	};

	fragment@53 {
		target = <0xffffffff>;

		__overlay__ {
			compatible = "mediatek,md1_sim2_hot_plug_eint-eint";
			debounce = <0x1 0x2710>;
			dedicated = <0x1 0x0>;
			interrupts = <0x1 0x8>;
			sockettype = <0x1 0x0>;
			src_pin = <0x1 0x2>;
			status = "okay";
		};
	};

	fragment@54 {
		target = <0xffffffff>;

		__overlay__ {
			regulator-default-on = <0x1>;
			regulator-name = "vcama";
			status = "okay";
		};
	};

	fragment@55 {
		target = <0xffffffff>;

		__overlay__ {
			regulator-default-on = <0x1>;
			regulator-name = "vsim1";
			status = "okay";
		};
	};

	fragment@56 {
		target = <0xffffffff>;

		__overlay__ {
			regulator-default-on = <0x1>;
			regulator-name = "vsim2";
			status = "okay";
		};
	};

	fragment@57 {
		target = <0xffffffff>;

		__overlay__ {
			regulator-default-on = <0x1>;
			regulator-name = "vcamd";
			status = "okay";
		};
	};

	fragment@58 {
		target = <0xffffffff>;

		__overlay__ {
			regulator-default-on = <0x1>;
			regulator-name = "vcamio";
			status = "okay";
		};
	};

	fragment@59 {
		target = <0xffffffff>;

		__overlay__ {
			regulator-default-on = <0x1>;
			regulator-name = "vldo28";
			status = "okay";
		};
	};

	fragment@6 {
		target = <0xffffffff>;

		__overlay__ {

			ext_buck_vgpu@55 {
				regulator-max-microvolt = <0x13d620>;
				regulator-min-microvolt = <0x493e0>;
				regulator-name = "ext_buck_vgpu";
				vsel_pin = <0x2>;
			};
		};
	};

	fragment@60 {
		target = <0xffffffff>;

		__overlay__ {
			status = "okay";
			vcama-supply = <0xffffffff>;
			vcama_sub-supply = <0xffffffff>;
			vcamaf-supply = <0xffffffff>;
			vcamaf_main2-supply = <0xffffffff>;
			vcamaf_sub-supply = <0xffffffff>;
			vcamd-supply = <0xffffffff>;
			vcamd_main2-supply = <0xffffffff>;
			vcamd_sub-supply = <0xffffffff>;
			vcamio-supply = <0xffffffff>;
			vcamio_main2-supply = <0xffffffff>;
			vcamio_sub-supply = <0xffffffff>;
		};
	};

	fragment@61 {
		target = <0xffffffff>;

		__overlay__ {
			status = "okay";
			vtouch-supply = <0xffffffff>;
		};
	};

	fragment@62 {
		target = <0xffffffff>;

		__overlay__ {
			mediatek,kpd-hw-dl-key0 = <0x0>;
			mediatek,kpd-hw-dl-key1 = <0x1>;
			mediatek,kpd-hw-dl-key2 = <0x8>;
			mediatek,kpd-hw-factory-key = <0x1>;
			mediatek,kpd-hw-init-map = <0x73 0x72 0x0 0x0 0x0 0x0 0x0 0x0 0x0 0x0 0x0 0x0 0x0 0x0 0x0 0x0 0x0 0x0 0x0 0x0 0x0 0x0 0x0 0x0 0x0 0x0 0x0 0x0 0x0 0x0 0x0 0x0 0x0 0x0 0x0 0x0 0x0 0x0 0x0 0x0 0x0 0x0 0x0 0x0 0x0 0x0 0x0 0x0 0x0 0x0 0x0 0x0 0x0 0x0 0x0 0x0 0x0 0x0 0x0 0x0 0x0 0x0 0x0 0x0 0x0 0x0 0x0 0x0 0x0 0x0 0x0 0x0>;
			mediatek,kpd-hw-map-num = <0x48>;
			mediatek,kpd-hw-pwrkey = <0x8>;
			mediatek,kpd-key-debounce = <0x400>;
			mediatek,kpd-pwkey-gpio-din = <0x0>;
			mediatek,kpd-pwrkey-eint-gpio = <0x0>;
			mediatek,kpd-sw-pwrkey = <0x74>;
			mediatek,kpd-use-extend-type = <0x0>;
			status = "okay";
		};
	};

	fragment@63 {
		target = <0xffffffff>;

		__overlay__ {

			cam0@0 {
				phandle = <0x2d>;

				pins_cmd_dat {
					output-low;
					pinmux = <0x6500>;
					slew-rate = <0x1>;
				};
			};

			cam0@1 {
				phandle = <0x2e>;

				pins_cmd_dat {
					output-high;
					pinmux = <0x6500>;
					slew-rate = <0x1>;
				};
			};

			cam0@2 {
				phandle = <0x2f>;

				pins_cmd_dat {
					output-low;
					pinmux = <0x6100>;
					slew-rate = <0x1>;
				};
			};

			cam0@3 {
				phandle = <0x30>;

				pins_cmd_dat {
					output-high;
					pinmux = <0x6100>;
					slew-rate = <0x1>;
				};
			};

			cam1@0 {
				phandle = <0x31>;

				pins_cmd_dat {
					output-low;
					pinmux = <0x6600>;
					slew-rate = <0x1>;
				};
			};

			cam1@1 {
				phandle = <0x32>;

				pins_cmd_dat {
					output-high;
					pinmux = <0x6600>;
					slew-rate = <0x1>;
				};
			};

			cam1@2 {
				phandle = <0x33>;

				pins_cmd_dat {
					output-low;
					pinmux = <0x6200>;
					slew-rate = <0x1>;
				};
			};

			cam1@3 {
				phandle = <0x34>;

				pins_cmd_dat {
					output-high;
					pinmux = <0x6200>;
					slew-rate = <0x1>;
				};
			};

			cam2@0 {
				phandle = <0x35>;

				pins_cmd_dat {
					output-low;
					pinmux = <0x6d00>;
					slew-rate = <0x1>;
				};
			};

			cam2@1 {
				phandle = <0x36>;

				pins_cmd_dat {
					output-high;
					pinmux = <0x6d00>;
					slew-rate = <0x1>;
				};
			};

			cam2@2 {
				phandle = <0x37>;

				pins_cmd_dat {
					output-low;
					pinmux = <0x6b00>;
					slew-rate = <0x1>;
				};
			};

			cam2@3 {
				phandle = <0x38>;

				pins_cmd_dat {
					output-high;
					pinmux = <0x6b00>;
					slew-rate = <0x1>;
				};
			};

			camdefault {
				phandle = <0x2c>;
			};

			camera_pins_cam0_mclk_off {
				phandle = <0x3a>;

				pins_cmd_dat {
					pinmux = <0x6300>;
				};
			};

			camera_pins_cam0_mclk_on {
				phandle = <0x39>;

				pins_cmd_dat {
					pinmux = <0x6301>;
				};
			};

			camera_pins_cam1_mclk_off {
				phandle = <0x3c>;

				pins_cmd_dat {
					pinmux = <0x6400>;
				};
			};

			camera_pins_cam1_mclk_on {
				phandle = <0x3b>;

				pins_cmd_dat {
					pinmux = <0x6401>;
				};
			};

			camera_pins_cam2_mclk_off {
				phandle = <0x3e>;

				pins_cmd_dat {
					pinmux = <0x6c00>;
				};
			};

			camera_pins_cam2_mclk_on {
				phandle = <0x3d>;

				pins_cmd_dat {
					pinmux = <0x6c01>;
				};
			};
		};
	};

	fragment@64 {
		target = <0xffffffff>;

		__overlay__ {
			cam0_enable_sensor = "hi846_mipi_raw gc08a3_mipi_raw";
			cam0_vcama-supply = <0xffffffff>;
			cam0_vcamaf-supply = <0xffffffff>;
			cam0_vcamd-supply = <0xffffffff>;
			cam0_vcamio-supply = <0xffffffff>;
			cam1_enable_sensor = "hi556_mipi_raw gc5035_mipi_raw";
			cam1_vcama-supply = <0xffffffff>;
			cam1_vcamd-supply = <0xffffffff>;
			cam1_vcamio-supply = <0xffffffff>;
			cam2_vcamd-supply = <0xffffffff>;
			cam2_vcamio-supply = <0xffffffff>;
			pinctrl-0 = <0x2c>;
			pinctrl-1 = <0x2d>;
			pinctrl-10 = <0x36>;
			pinctrl-11 = <0x37>;
			pinctrl-12 = <0x38>;
			pinctrl-13 = <0x39>;
			pinctrl-14 = <0x3a>;
			pinctrl-15 = <0x3b>;
			pinctrl-16 = <0x3c>;
			pinctrl-17 = <0x3d>;
			pinctrl-18 = <0x3e>;
			pinctrl-2 = <0x2e>;
			pinctrl-3 = <0x2f>;
			pinctrl-4 = <0x30>;
			pinctrl-5 = <0x31>;
			pinctrl-6 = <0x32>;
			pinctrl-7 = <0x33>;
			pinctrl-8 = <0x34>;
			pinctrl-9 = <0x35>;
			pinctrl-names = "default", "cam0_rst0", "cam0_rst1", "cam0_pnd0", "cam0_pnd1", "cam1_rst0", "cam1_rst1", "cam1_pnd0", "cam1_pnd1", "cam2_rst0", "cam2_rst1", "cam2_pnd0", "cam2_pnd1", "cam0_mclk_on", "cam0_mclk_off", "cam1_mclk_on", "cam1_mclk_off", "cam2_mclk_on", "cam2_mclk_off";
			status = "okay";
		};
	};

	fragment@65 {
		target = <0xffffffff>;

		__overlay__ {

			aw36515default {
				phandle = <0x3f>;
			};

			aw36515hwen_high {
				phandle = <0x40>;

				pins_cmd_dat {
					output-high;
					pinmux = <0x9800>;
					slew-rate = <0x1>;
				};
			};

			aw36515hwen_low {
				phandle = <0x41>;

				pins_cmd_dat {
					output-low;
					pinmux = <0x9800>;
					slew-rate = <0x1>;
				};
			};

			ocp81375default {
				phandle = <0x42>;
			};

			ocp81375hwen_high {
				phandle = <0x43>;

				pins_cmd_dat {
					output-high;
					pinmux = <0x9800>;
					slew-rate = <0x1>;
				};
			};

			ocp81375hwen_low {
				phandle = <0x44>;

				pins_cmd_dat {
					output-low;
					pinmux = <0x9800>;
					slew-rate = <0x1>;
				};
			};
		};
	};

	fragment@66 {
		target = <0xffffffff>;

		__overlay__ {
			pinctrl-0 = <0x3f>;
			pinctrl-1 = <0x40>;
			pinctrl-2 = <0x41>;
			pinctrl-names = "aw36515default", "aw36515hwen_high", "aw36515hwen_low";
			status = "okay";
		};
	};

	fragment@67 {
		target = <0xffffffff>;

		__overlay__ {
			pinctrl-0 = <0x42>;
			pinctrl-1 = <0x43>;
			pinctrl-2 = <0x44>;
			pinctrl-names = "ocp81375default", "ocp81375hwen_high", "ocp81375hwen_low";
			status = "okay";
		};
	};

	fragment@7 {
		target = <0xffffffff>;

		__overlay__ {
			cam0_enable_sensor = "hi846_mipi_raw gc08a3_mipi_raw";
			cam1_enable_sensor = "hi556_mipi_raw gc5035_mipi_raw";
			cam2_enable_sensor = "fake_serial_yuv";
			camera_input_gpio = <0xffffffff 0xb 0x0>;
			pmic = <0xffffffff>;
		};
	};

	fragment@8 {
		target = <0xffffffff>;

		__overlay__ {

			dispdefault {
				phandle = <0x1>;
			};

			lcd_bias_enn0_gpio {
				phandle = <0x6>;

				pins_cmd_dat {
					output-low;
					pinmux = <0x9f00>;
					slew-rate = <0x1>;
				};
			};

			lcd_bias_enn1_gpio {
				phandle = <0x7>;

				pins_cmd_dat {
					output-high;
					pinmux = <0x9f00>;
					slew-rate = <0x1>;
				};
			};

			lcd_bias_enp0_gpio {
				phandle = <0x4>;

				pins_cmd_dat {
					output-low;
					pinmux = <0x9a00>;
					slew-rate = <0x1>;
				};
			};

			lcd_bias_enp1_gpio {
				phandle = <0x5>;

				pins_cmd_dat {
					output-high;
					pinmux = <0x9a00>;
					slew-rate = <0x1>;
				};
			};

			lcm_rst_out0_gpio {
				phandle = <0x2>;

				pins_cmd_dat {
					output-low;
					pinmux = <0x2d00>;
					slew-rate = <0x1>;
				};
			};

			lcm_rst_out1_gpio {
				phandle = <0x3>;

				pins_cmd_dat {
					output-high;
					pinmux = <0x2d00>;
					slew-rate = <0x1>;
				};
			};
		};
	};

	fragment@9 {
		target = <0xffffffff>;

		__overlay__ {
			pinctrl-0 = <0x1>;
			pinctrl-1 = <0x2>;
			pinctrl-2 = <0x3>;
			pinctrl-3 = <0x4>;
			pinctrl-4 = <0x5>;
			pinctrl-5 = <0x6>;
			pinctrl-6 = <0x7>;
			pinctrl-names = "dispdefault", "lcm_rst_out0_gpio", "lcm_rst_out1_gpio", "lcd_bias_enp0_gpio", "lcd_bias_enp1_gpio", "lcd_bias_enn0_gpio", "lcd_bias_enn1_gpio";
			status = "okay";
		};
	};
};
